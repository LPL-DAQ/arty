/dts-v1/;

#include <../boards/st/nucleo_h755zi_q/nucleo_h755zi_q_stm32h755xx_m7.dts>


/ {
	model = "Hive Dev Board (STMicroelectronics STM32H755ZI-Q-NUCLEO board)";
	compatible = "st,stm32h755zi-q-nucleo";
};
