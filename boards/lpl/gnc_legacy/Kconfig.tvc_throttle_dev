## boards/lpl/gnc_legacy/board.yml
```yaml
boards:
  - name: throttle_legacy
    vendor: lpl
    socs:
      - name: mimxrt1062
  - name: tvc_throttle_dev
    vendor: lpl
    socs:
      - name: mimxrt1062
```

## boards/lpl/gnc_legacy/tvc_throttle_dev_defconfig
```kconfig
# Clover settings
CONFIG_RANGER=y

# CONFIG_UART_LOGGING=y

CONFIG_FLIGHT=n

CONFIG_RANGER_THROTTLE=y
CONFIG_RANGER_TVC=n
CONFIG_RANGER_RCS=n

CONFIG_ETHERNET=y
CONFIG_RF=n

CONFIG_LIDAR=n
CONFIG_IMU=n
CONFIG_GNSS=n
CONFIG_ANALOG_SENSORS=y

CONFIG_VALVES=n
CONFIG_THROTTLE_VALVES=y
CONFIG_TVC_ACTUATORS=n
CONFIG_PWM_ACTUATORS=n

# And other stuff
CONFIG_BUILD_OUTPUT_HEX=y

CONFIG_DEVICE_CONFIGURATION_DATA=n
CONFIG_CONSOLE=y
CONFIG_UART_CONSOLE=y
CONFIG_SERIAL=y
CONFIG_GPIO=y
CONFIG_SYS_CLOCK_HW_CYCLES_PER_SEC=600000000
CONFIG_ARM_MPU=y
CONFIG_HW_STACK_PROTECTION=y
CONFIG_STDOUT_CONSOLE=y
CONFIG_FPU=y
CONFIG_FPU_SHARING=y
CONFIG_ADC=y
CONFIG_COUNTER=y

CONFIG_LOG=y
CONFIG_GPIO=y

CONFIG_USB_DEVICE_STACK=y
CONFIG_USB_CDC_ACM=y
CONFIG_USB_DEVICE_PRODUCT="LPL GNC Throttle/TVC Dev Board"
CONFIG_USB_DRIVER_LOG_LEVEL_ERR=y
CONFIG_USB_DEVICE_LOG_LEVEL_ERR=y
CONFIG_UART_INTERRUPT_DRIVEN=y
CONFIG_UART_LINE_CTRL=y
CONFIG_USB_DEVICE_VID=0x6767
CONFIG_USB_DEVICE_PID=0x6767
```

## boards/lpl/hive/dev_board/Kconfig.dev_board
```kconfig
config BOARD_DEV_BOARD
	select SOC_STM32H755XX_M7 if BOARD_DEV_BOARD_STM32H755XX_M7
```

## boards/lpl/hive/dev_board/board.yml
```yaml
board:
  name: dev_board
  full_name: Hive Dev Board (Nucleo H755ZI-Q)
  vendor: st
  socs:
    - name: stm32h755xx
```

## boards/lpl/hive/fs_board/fs_board_defconfig
```kconfig
# Copyright (c) 2024 John Sanpe <sanpeqf@gmail.com>
# SPDX-License-Identifier: Apache-2.0

# Enable the internal SMPS regulator
CONFIG_POWER_SUPPLY_LDO=y
CONFIG_BOOT_BANNER=y

# Enable MPU
CONFIG_ARM_MPU=y

# Enable HW stack protection
CONFIG_HW_STACK_PROTECTION=y

CONFIG_SERIAL=y
CONFIG_UART_INTERRUPT_DRIVEN=y

# enable GPIO
CONFIG_GPIO=y

# Enable Clocks
CONFIG_CLOCK_CONTROL=y

# eMMC
CONFIG_DISK_ACCESS=y
CONFIG_DISK_DRIVER_SDMMC=y
CONFIG_SDMMC_STM32=y
CONFIG_SDMMC_STM32_EMMC=y

# # Optional: FAT filesystem if eMMC is FAT-formatted
# CONFIG_FILE_SYSTEM=y
# CONFIG_FAT_FILESYSTEM_ELM=y

# Logging
# console
CONFIG_LOG=y
CONFIG_LOG_MODE_IMMEDIATE=y
CONFIG_CONSOLE=y


CONFIG_LOG_DEFAULT_LEVEL=4
CONFIG_LOG_BACKEND_UART=y
CONFIG_UART_CONSOLE=y
CONFIG_LOG_OUTPUT=y

CONFIG_MAIN_STACK_SIZE=4096
CONFIG_SYSTEM_WORKQUEUE_STACK_SIZE=2048

# CONFIG_LOG_BACKEND_RTT is not set
# CONFIG_USE_SEGGER_RTT is not set
```

## boards/lpl/hive/gse_board/Kconfig.defconfig
```kconfig
# YD-STM32H750VB board configuration

# Copyright(c) 2024 John Sanpe <sanpeqf@gmail.com>
# SPDX-License-Identifier: Apache-2.0

if BOARD_GSE_BOARD

config DISK_DRIVER_SDMMC
	default y if DISK_DRIVERS

endif # BOARD_HIVE_GSE
```

## boards/lpl/hive/nuc_board/board.yml
```yaml
# Copyright (c) 2024 Nordic Semiconductor ASA
# SPDX-License-Identifier: Apache-2.0

board:
  name: nuc_board
  vendor: lpl
  socs:
    - name: stm32h750xx
```

## boards/lpl/hive/throttle_legacy_defconfig
```kconfig
CONFIG_BUILD_OUTPUT_HEX=y

CONFIG_DEVICE_CONFIGURATION_DATA=n
CONFIG_CONSOLE=y
CONFIG_UART_CONSOLE=y
CONFIG_SERIAL=y
CONFIG_GPIO=y
CONFIG_SYS_CLOCK_HW_CYCLES_PER_SEC=600000000
CONFIG_ARM_MPU=y
CONFIG_HW_STACK_PROTECTION=y
CONFIG_STDOUT_CONSOLE=y
CONFIG_FPU=y
CONFIG_FPU_SHARING=y
CONFIG_ADC=y
CONFIG_COUNTER=y

CONFIG_LOG=y
CONFIG_GPIO=y

CONFIG_USB_DEVICE_STACK=y
CONFIG_USB_CDC_ACM=y
CONFIG_USB_DEVICE_PRODUCT="LPL GNC Throttle Legacy"
CONFIG_USB_DRIVER_LOG_LEVEL_ERR=y
CONFIG_USB_DEVICE_LOG_LEVEL_ERR=y
CONFIG_UART_INTERRUPT_DRIVEN=y
CONFIG_UART_LINE_CTRL=y
CONFIG_USB_DEVICE_VID=0x6767
CONFIG_USB_DEVICE_PID=0x6767
```

## boards/lpl/teensy_hive/board.yml
```yaml
boards:
  - name: hornet_mk_3
    full_name: Hornet Mk. 3
    vendor: lpl
    socs:
      - name: mimxrt1062
  - name: ranger_1
    full_name: Ranger 1
    vendor: lpl
    socs:
      - name: mimxrt1062
```

## drivers/vn300/Kconfig
```kconfig
# SPDX-License-Identifier: Apache-2.0
menuconfig VN300
        bool "VectorNav VN-300 IMU driver"
        help
          Enable the VN-300 IMU/GNSS driver over UART.

if VN300

module = VN300
module-str = vn300
source "subsys/logging/Kconfig.template.log_config"

endif # VN300
```

## lora-pinger/build/Kconfig/boards/Kconfig.defconfig
```kconfig
# Load Zephyr board defconfig descriptions.
osource "/home/lpl/zephyr/boards/pjrc/teensy4/Kconfig.defconfig"
```

## lora-responder/build/Kconfig/Kconfig.modules
```kconfig
menu "arty (/home/lpl/arty)"
osource "/workspaces/arty/Kconfig"
config ZEPHYR_ARTY_MODULE
	bool
	default y
endmenu
menu "arduino-api (/home/lpl/modules/lib/Arduino-Zephyr-API)"
osource "/home/lpl/modules/lib/Arduino-Zephyr-API/Kconfig"
config ZEPHYR_ARDUINO_API_MODULE
	bool
	default y
endmenu
menu "nanopb (/home/lpl/modules/lib/nanopb)"
osource "$(ZEPHYR_NANOPB_KCONFIG)"
config ZEPHYR_NANOPB_MODULE
	bool
	default y
endmenu
menu "cmsis_6 (/home/lpl/modules/hal/cmsis_6)"
osource "$(ZEPHYR_CMSIS_6_KCONFIG)"
config ZEPHYR_CMSIS_6_MODULE
	bool
	default y
endmenu
menu "hal_nxp (/home/lpl/modules/hal/nxp)"
osource "$(ZEPHYR_HAL_NXP_KCONFIG)"
config ZEPHYR_HAL_NXP_MODULE
	bool
	default y

config ZEPHYR_HAL_NXP_MODULE_BLOBS
	bool
endmenu
config ZEPHYR_HAL_STM32_MODULE
	bool
	default y

config ZEPHYR_HAL_STM32_MODULE_BLOBS
	bool
menu "loramac-node (/home/lpl/modules/lib/loramac-node)"
osource "$(ZEPHYR_LORAMAC_NODE_KCONFIG)"
config ZEPHYR_LORAMAC_NODE_MODULE
	bool
	default y
endmenu
```

## lora-responder/build/Kconfig/boards/Kconfig
```kconfig
# Load Zephyr board Kconfig descriptions.
osource "/home/lpl/zephyr/boards/pjrc/teensy4/Kconfig"
```

## lora-responder/build/Kconfig/boards/Kconfig.sysbuild
```kconfig
# Load Sysbuild board Kconfig descriptions.
osource "/home/lpl/zephyr/boards/pjrc/teensy4/Kconfig.sysbuild"
```
