## CMakeLists.txt
```
cmake_minimum_required(VERSION 3.13.1)
find_package(Zephyr REQUIRED HINTS $ENV{ZEPHYR_BASE})

message(STATUS "C compiler: ${CMAKE_C_COMPILER}")
message(STATUS "C++ compiler: ${CMAKE_CPP_COMPILER}")

project(app)

# Add nanopb dependency
list(APPEND CMAKE_MODULE_PATH ${ZEPHYR_BASE}/modules/nanopb)
include(nanopb)

zephyr_include_directories(${CMAKE_CURRENT_BINARY_DIR})
zephyr_nanopb_sources(app ../../api/clover.proto)

target_include_directories(app PRIVATE ../../clover/src)
add_subdirectory(src)
```

## Kconfig
```
source "Kconfig.zephyr"
rsource "../../clover/Kconfig.estimator"
```

## prj.conf
```kconfig
CONFIG_ZTEST=y
CONFIG_USE_ZAXIS_EKF_FOR_ALTITUDE=y
CONFIG_NANOPB=y

CONFIG_CPP=y
CONFIG_STD_CPP2B=y  # Applies std=C++23
CONFIG_REQUIRES_FULL_LIBC=y
CONFIG_REQUIRES_FULL_LIBCPP=y
CONFIG_MINIMAL_LIBCPP=n
CONFIG_NEWLIB_LIBC=y
CONFIG_CBPRINTF_LIBC_SUBSTS=y
CONFIG_EXTERNAL_LIBC=n
```

## src/MaxLengthString_test.cpp
```c
#include "MaxLengthString.h"
#include <cstring>
#include <zephyr/ztest.h>

ZTEST(MaxLengthString_test, test_default_constructor)
{
    MaxLengthString<5> str;

    zassert_equal(std::strcmp(str.c_str(), ""), 0);
    zassert_equal(str.string_view(), "");
    zassert_equal(str.size(), 0);
}

ZTEST(MaxLengthString_test, test_formatted_constructor)
{
    // Basic integer formatting
    {
        MaxLengthString<5> str("%d", -2);

        zassert_equal(std::strcmp(str.c_str(), "-2"), 0);
        zassert_equal(str.string_view(), "-2");
        zassert_equal(str.size(), 2);
    }

    {
        MaxLengthString<8> str("%d", 42112321);

        zassert_equal(std::strcmp(str.c_str(), "42112321"), 0);
        zassert_equal(str.string_view(), "42112321");
        zassert_equal(str.size(), 8);
    }

    {
        MaxLengthString<8> str("%d", 0);

        zassert_equal(std::strcmp(str.c_str(), "0"), 0);
        zassert_equal(str.string_view(), "0");
        zassert_equal(str.size(), 1);
    }

    // Basic string formatting
    {
        MaxLengthString<5> str("%s", "-2");

        zassert_equal(std::strcmp(str.c_str(), "-2"), 0);
        zassert_equal(str.string_view(), "-2");
        zassert_equal(str.size(), 2);
    }

    {
        MaxLengthString<25> str("%s", "fnjcxvklnm,fkjdashjkfdhas");

        zassert_equal(std::strcmp(str.c_str(), "fnjcxvklnm,fkjdashjkfdhas"), 0);
        zassert_equal(str.string_view(), "fnjcxvklnm,fkjdashjkfdhas");
        zassert_equal(str.size(), 25);
    }

    // Basic float formatting
    {
        MaxLengthString<8> str("%f.2f", 32.5);

        zassert_equal(str.string_view(), "32.50");
        zassert_equal(std::strcmp(str.c_str(), "32.50"), 0);
        zassert_equal(str.size(), 5);
    }

    // Multiple formatters
    {
        MaxLengthString<60> str("%d%d%s%f.1f%svncxmz,vnmz,cxnvm,czn,mvzx%d%f.3f%s", 2, 3, "hey", 4.5, "what", -2323, 9.999, "bruhhhh");

        zassert_equal(std::strcmp(str.c_str(), "23hey4.5whatvncxmz,vnmz,cxnvm,czn,mvzx-23239.999bruhhh"), 0);
        zassert_equal(str.string_view(), "23hey4.5whatvncxmz,vnmz,cxnvm,czn,mvzx-23239.999bruhhh");
        zassert_equal(str.size(), 54);
    }
}

ZTEST_SUITE(MaxLengthString_test, NULL, NULL, NULL, NULL, NULL);
```

## src/Trace_test.cpp
```c
#include "Trace.h"
#include <zephyr/ztest.h>

ZTEST(Trace_test, test_get_value)
{
    Trace trace;
    zassert_false(trace.sample(0).has_value());
}

ZTEST_SUITE(Trace_test, NULL, NULL, NULL, NULL, NULL);
```
