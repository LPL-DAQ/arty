## prj.conf
```kconfig
CONFIG_ZTEST=y
CONFIG_NANOPB=y

CONFIG_CPP=y
CONFIG_STD_CPP2B=y  # Applies std=C++23
CONFIG_REQUIRES_FULL_LIBC=y
CONFIG_REQUIRES_FULL_LIBCPP=y
CONFIG_MINIMAL_LIBCPP=n
CONFIG_NEWLIB_LIBC=y
CONFIG_CBPRINTF_LIBC_SUBSTS=y
CONFIG_EXTERNAL_LIBC=n
```

## src/LookupTable1D_test_lut_simple.h
~~~~c
#pragma once

/*
>>> GENERATED FILE <<<

Re-create this whenever tests/darwin/src/LookupTable1D_test_simple.csv changes by running from the arty directory:
```
uv --project ~/arty/scripts run ~/arty/scripts/gen_lookup_table_1d.py test_lut_simple 2 -5.0 5.0 10.0 tests/darwin/src/LookupTable1D_test_simple.csv tests/darwin/src/LookupTable1D_test_lut_simple.h
```
*/

#include <array>
#include "LookupTable1D.h"

constexpr int TEST_LUT_SIMPLE_X_LEN = 2;
constexpr float TEST_LUT_SIMPLE_X_MIN = -5.0000000000f;
constexpr float TEST_LUT_SIMPLE_X_MAX = 5.0000000000f;
constexpr float TEST_LUT_SIMPLE_X_GAP = 10.0000000000f;

constexpr std::array<float, TEST_LUT_SIMPLE_X_LEN> TEST_LUT_SIMPLE_BPS {-50.0000000000, 50.0000000000};

typedef LookupTable1D<TEST_LUT_SIMPLE_X_LEN, TEST_LUT_SIMPLE_X_MIN, TEST_LUT_SIMPLE_X_MAX, TEST_LUT_SIMPLE_X_GAP, TEST_LUT_SIMPLE_BPS> TestLutSimple;
~~~~

## src/LookupTable1D_test_simple.cpp
```c
#include "LookupTable1D.h"
#include "LookupTable1D_test_lut_simple.h"
#include <iostream>
#include <zephyr/ztest.h>

constexpr float EPSILON = 0.001f;

ZTEST(LookupTable1D_test_simple, test_left_boundary)
{
    float val = TestLutSimple::sample(-5.0f);
    std::cout << "Got: " << val << std::endl;
    zassert_within(val, -50.0f, EPSILON);
}

ZTEST(LookupTable1D_test_simple, test_right_boundary)
{
    float val = TestLutSimple::sample(5.0f);
    std::cout << "Got: " << val << std::endl;
    zassert_within(val, 50.0f, EPSILON, "val=%f");
}

ZTEST(LookupTable1D_test_simple, test_intermediate_values)
{
    for (int i = 1; i < 1000; ++i) {
        float in = -5.0f + i * 0.01f;
        float expected_out = in * 10.0f;
        float actual_out = TestLutSimple::sample(in);

        std::cout << "Got: in=" << in << ", expected_out=" << expected_out << ", actual_out=" << actual_out << std::endl;
        zassert_within(expected_out, actual_out, EPSILON);
    }
}

ZTEST(LookupTable1D_test_simple, test_clamp_left)
{
    for (int i = 1; i < 1000; ++i) {
        float in = -5.0f - i;
        float val = TestLutSimple::sample(in);

        std::cout << "in=" << in << ", val=" << val << std::endl;
        zassert_within(val, -50.0f, EPSILON);
    }
}

ZTEST(LookupTable1D_test_simple, test_clamp_right)
{
    for (int i = 1; i < 1000; ++i) {
        float in = 5.0f + i;
        float val = TestLutSimple::sample(in);

        std::cout << "in=" << in << ", val=" << val << std::endl;
        zassert_within(val, 50.0f, EPSILON);
    }
}

ZTEST_SUITE(LookupTable1D_test_simple, NULL, NULL, NULL, NULL, NULL);
```
