## CMakeLists.txt
```
cmake_minimum_required(VERSION 3.20.0)
set(CONFIG_MCUX_COMPONENT_driver.lpspi ON)
find_package(Zephyr REQUIRED HINTS $ENV{ZEPHYR_BASE})
project(valve_gpio_test)
# These modes provide different main functions; compile exactly one entry point.
if(CONFIG_VALVE_TEST_EMBEDDED_SEQUENCE)
    set(VALVE_SEQUENCE_DIR "${CMAKE_CURRENT_SOURCE_DIR}/sequences" CACHE PATH "Directory of named JSON sequences")
    # Preserve explicit single-file builds; the normal build embeds the directory.
    if(VALVE_SEQUENCE_FILE)
        get_filename_component(sequence_input "${VALVE_SEQUENCE_FILE}" ABSOLUTE BASE_DIR "${CMAKE_CURRENT_SOURCE_DIR}")
        set(sequence_files "${sequence_input}")
    else()
        get_filename_component(sequence_input "${VALVE_SEQUENCE_DIR}" ABSOLUTE BASE_DIR "${CMAKE_CURRENT_SOURCE_DIR}")
        file(GLOB sequence_files CONFIGURE_DEPENDS "${sequence_input}/*.json")
    endif()
    set(VALVE_MAP_FILE "${CMAKE_CURRENT_SOURCE_DIR}/valve_map.json" CACHE FILEPATH "Valve-name to GPIO-channel mapping")
    get_filename_component(VALVE_MAP_FILE "${VALVE_MAP_FILE}" ABSOLUTE BASE_DIR "${CMAKE_CURRENT_SOURCE_DIR}")
    set(sequence_header "${CMAKE_CURRENT_BINARY_DIR}/generated/valve_sequence.h")
    # Revalidate and regenerate tables whenever sequences, wiring or loaders change.
    add_custom_command(
        OUTPUT "${sequence_header}"
        COMMAND ${PYTHON_EXECUTABLE} "${CMAKE_CURRENT_SOURCE_DIR}/generate_sequence.py"
                "${sequence_input}" "${sequence_header}" --valve-map "${VALVE_MAP_FILE}"
        DEPENDS ${sequence_files} "${VALVE_MAP_FILE}"
                "${CMAKE_CURRENT_SOURCE_DIR}/generate_sequence.py"
                "${CMAKE_CURRENT_SOURCE_DIR}/run_sequence.py"
        VERBATIM)
    # Share Clover wire definitions while keeping GPIO execution in this test app.
    list(APPEND CMAKE_MODULE_PATH ${ZEPHYR_BASE}/modules/nanopb)
    include(nanopb)
    zephyr_nanopb_sources(app ../../api/clover.proto)
    target_sources(app PRIVATE src/embedded_sequence.c src/sequence_server.c src/sequence_protocol.c "${sequence_header}")
    target_include_directories(app PRIVATE "${CMAKE_CURRENT_BINARY_DIR}/generated")
else()
    target_sources(app PRIVATE src/main.c)
endif()
```

## Kconfig
```
source "Kconfig.zephyr"

# Board defconfig settings normally supplied by Clover.
config RANGER
    bool "Ranger board defaults"
config RF
    bool "RF board defaults (unused by this test)"

# CMake uses this mode flag to choose the application main function.
config VALVE_TEST_EMBEDDED_SEQUENCE
    bool "Run named embedded JSON sequences on USB command"
    default n
```

## prj.conf
```kconfig
CONFIG_GPIO=y
CONFIG_I2C=y
CONFIG_SHELL=y
CONFIG_SHELL_BACKEND_SERIAL=y
CONFIG_UART_CONSOLE=n
CONFIG_STDOUT_CONSOLE=n
CONFIG_LOG_BACKEND_UART=n
CONFIG_USB_DEVICE_STACK=y
CONFIG_USB_CDC_ACM=y
CONFIG_UART_LINE_CTRL=y
CONFIG_MAIN_STACK_SIZE=2048
CONFIG_SHELL_ARGC_MAX=40
CONFIG_SHELL_BACKEND_SERIAL_RX_RING_BUFFER_SIZE=256
CONFIG_LOG=y
CONFIG_LOG_DEFAULT_LEVEL=3

# Direct Ethernet connection, using the same static IPv4 address as Clover.
CONFIG_NETWORKING=y
CONFIG_NET_L2_ETHERNET=y
CONFIG_NET_IPV4=y
CONFIG_NET_IPV6=n
CONFIG_NET_CONFIG_SETTINGS=y
CONFIG_NET_CONFIG_AUTO_INIT=y
CONFIG_NET_CONFIG_NEED_IPV4=y
CONFIG_NET_CONFIG_MY_IPV4_ADDR="169.254.99.99"
CONFIG_NET_CONFIG_MY_IPV4_NETMASK="255.255.0.0"
CONFIG_NET_CONFIG_INIT_TIMEOUT=0
CONFIG_NET_SHELL=y

# Build the named-sequence engine and Clover-compatible TCP transport.
CONFIG_VALVE_TEST_EMBEDDED_SEQUENCE=y
CONFIG_NANOPB=y
CONFIG_NET_TCP=y
CONFIG_NET_SOCKETS=y
```

## automatic.conf
```kconfig
CONFIG_VALVE_TEST_AUTOMATIC=y
CONFIG_VALVE_TEST_CHANNEL=1
```

## sequence.conf
```kconfig
# Build the named-sequence engine and Clover-compatible TCP transport.
CONFIG_VALVE_TEST_EMBEDDED_SEQUENCE=y
CONFIG_VALVE_TEST_AUTOMATIC=n
CONFIG_NANOPB=y
CONFIG_NET_TCP=y
CONFIG_NET_SOCKETS=y
```

## app.overlay
```dts
/ {
    chosen {
        zephyr,shell-uart = &cdc_acm_uart0;
    };
};

/* The board's fixed 67:... address has the multicast bit set. Use a
 * device-derived unicast address for the test's Ethernet interface. */
&enet_mac {
    /delete-property/ local-mac-address;
    nxp,unique-mac;
};
```

## src/main.c
```c
/* Default USB-shell firmware: each pulse/group completes inside its shell handler.
 * Select embedded-sequence firmware for independently running named sequences. */
#include <errno.h>
#include <stdlib.h>
#include <stdint.h>
#include <zephyr/drivers/gpio.h>
#include <zephyr/kernel.h>
#include <zephyr/shell/shell.h>
#include <zephyr/usb/usb_device.h>

static const struct gpio_dt_spec valves[] = {
    DT_FOREACH_PROP_ELEM_SEP(DT_PATH(zephyr_user), valve_gpios,
                             GPIO_DT_SPEC_GET_BY_IDX, (,))
};
static bool ready;

/* Reject partial numbers and overflow before using input as an index or duration. */
static int number(const char *text, unsigned long maximum, unsigned long *value)
{
    char *end;
    errno = 0;
    *value = strtoul(text, &end, 10);
    return errno || end == text || *end || *value > maximum ? -EINVAL : 0;
}

static void report(const struct shell *sh, unsigned long channel)
{
    const struct gpio_dt_spec *pin = &valves[channel];
    int raw = gpio_pin_get_raw(pin->port, pin->pin);
    if (raw < 0) {
        shell_error(sh, "Channel %lu read failed: %d", channel, raw);
        return;
    }
    shell_print(sh, "Channel %lu: %s pin %u, active-%s, raw=%d (%s), logical=%d",
                channel, pin->port->name, pin->pin,
                pin->dt_flags & GPIO_ACTIVE_LOW ? "low" : "high",
                raw, raw ? "HIGH" : "LOW",
                raw ^ !!(pin->dt_flags & GPIO_ACTIVE_LOW));
}

static int cmd_list(const struct shell *sh, size_t argc, char **argv)
{
    ARG_UNUSED(argc);
    ARG_UNUSED(argv);
    if (!ready) {
        shell_error(sh, "GPIO initialization failed; reset after checking hardware.");
        return -ENODEV;
    }
    for (size_t i = 0; i < ARRAY_SIZE(valves); ++i) {
        report(sh, i);
    }
    return 0;
}

static int cmd_pulse(const struct shell *sh, size_t argc, char **argv)
{
    unsigned long channel, duration = 1000;
    if (!ready) {
        shell_error(sh, "GPIO initialization failed; reset after checking hardware.");
        return -ENODEV;
    }
    if (number(argv[1], ARRAY_SIZE(valves) - 1, &channel) ||
        (argc == 3 && number(argv[2], INT32_MAX, &duration)) || duration == 0) {
        shell_error(sh, "Use valve pulse <channel 0..%u> [duration 1..2147483647 ms]",
                    (unsigned int)ARRAY_SIZE(valves) - 1);
        return -EINVAL;
    }
    const struct gpio_dt_spec *pin = &valves[channel];
    shell_print(sh, "Before:");
    report(sh, channel);
    int err = gpio_pin_set_dt(pin, 1);
    if (!err) {
        shell_print(sh, "Active for %lu ms:", duration);
        report(sh, channel);
        k_msleep(duration);
    }
    /* Always attempt to turn off, including after an activation error. */
    int off_err = gpio_pin_set_dt(pin, 0);
    shell_print(sh, "After:");
    report(sh, channel);
    if (err || off_err) {
        shell_error(sh, "GPIO write failed: activation=%d, deactivation=%d", err, off_err);
    }
    return err ? err : off_err;
}

/* Machine-readable completion includes a caller token to reject stale replies. */
static int cmd_group(const struct shell *sh, size_t argc, char **argv)
{
    unsigned long token, duration, channels[ARRAY_SIZE(valves)];
    if (number(argv[1], 2147483647UL, &token)) {
        return -EINVAL;
    }
    int err = 0;
    if (!ready) {
        err = -ENODEV;
        goto done;
    }
    if (number(argv[2], INT32_MAX, &duration) || duration == 0 ||
        argc - 3 > ARRAY_SIZE(valves)) {
        err = -EINVAL;
        goto done;
    }
    /* Validate the entire group before touching hardware. */
    for (size_t i = 3; i < argc; ++i) {
        if (number(argv[i], ARRAY_SIZE(valves) - 1, &channels[i - 3])) {
            err = -EINVAL;
            goto done;
        }
        for (size_t j = 3; j < i; ++j) {
            if (channels[j - 3] == channels[i - 3]) {
                err = -EINVAL;
                goto done;
            }
        }
    }
    for (size_t i = 3; i < argc; ++i) {
        err = gpio_pin_set_dt(&valves[channels[i - 3]], 1);
        if (err) {
            break;
        }
    }
    if (!err) {
        k_msleep(duration);
    }
    /* Attempt every deactivation even if activation or another off write failed. */
    for (size_t i = 3; i < argc; ++i) {
        int off_err = gpio_pin_set_dt(&valves[channels[i - 3]], 0);
        if (!err) {
            err = off_err;
        }
    }
done:
    shell_print(sh, "VALVE_DONE %lu %d", token, err);
    return err;
}

SHELL_STATIC_SUBCMD_SET_CREATE(valve_commands,
    SHELL_CMD_ARG(list, NULL, "List channels and digital pin readback", cmd_list, 1, 0),
    SHELL_CMD_ARG(pulse, NULL, "Pulse <channel> [milliseconds, default 1000]", cmd_pulse, 2, 1),
    SHELL_CMD_ARG(group, NULL, "Group <token> <milliseconds> <channel> [channels...]", cmd_group, 4, 31),
    SHELL_SUBCMD_SET_END);
SHELL_CMD_REGISTER(valve, &valve_commands, "Valve GPIO bench test", NULL);

int main(void)
{
    bool ok = true;
    for (size_t i = 0; i < ARRAY_SIZE(valves); ++i) {
        if (!gpio_is_ready_dt(&valves[i]) ||
            gpio_pin_configure_dt(&valves[i], GPIO_OUTPUT_INACTIVE)) {
            ok = false;
        }
    }
    /* Expose diagnostics over USB even when initialization blocks pulse commands. */
    ready = ok;
    return usb_enable(NULL);
}
```

## src/automatic.c
```c
/* Boot-only diagnostic: initialize all outputs, wait, pulse one channel, then stop. */
#include <zephyr/drivers/gpio.h>
#include <zephyr/kernel.h>
#include <zephyr/sys/util.h>
#include "test_trace.h"

static const struct gpio_dt_spec valves[] = {
    DT_FOREACH_PROP_ELEM_SEP(DT_PATH(zephyr_user), valve_gpios,
                             GPIO_DT_SPEC_GET_BY_IDX, (,))
};

BUILD_ASSERT(CONFIG_VALVE_TEST_CHANNEL < ARRAY_SIZE(valves),
             "Selected valve channel is not present on this board");

int main(void)
{
    trace_start("automatic single-channel");
    bool ready = true;
    /* Initialize every valve output inactive before allowing a pulse. */
    for (size_t i = 0; i < ARRAY_SIZE(valves); ++i) {
        int err = gpio_is_ready_dt(&valves[i]) ?
            gpio_pin_configure_dt(&valves[i], GPIO_OUTPUT_INACTIVE) : -ENODEV;
        trace_event("INIT channel=%u port=%s pin=%u result=%d",
                    (unsigned)i, valves[i].port->name, valves[i].pin, err);
        if (err) {
            ready = false;
        }
    }
    if (!ready) {
        trace_event("STOP: initialization failed");
        return -ENODEV;
    }
 
    const struct gpio_dt_spec *valve = &valves[CONFIG_VALVE_TEST_CHANNEL];
    trace_event("Waiting 15 seconds before channel %d pulse", CONFIG_VALVE_TEST_CHANNEL);
    k_sleep(K_SECONDS(15));
    /* Hold one output active long enough to position and read a multimeter. */
    int err = gpio_pin_set_dt(valve, 1);
    trace_event("ON channel=%d result=%d raw_readback=%d", CONFIG_VALVE_TEST_CHANNEL,
                err, gpio_pin_get_raw(valve->port, valve->pin));
    if (err) {
        int off_err = gpio_pin_set_dt(valve, 0);
        trace_event("STOP: activation failed; cleanup result=%d", off_err);
        return err;
    }
    k_sleep(K_SECONDS(60));
    err = gpio_pin_set_dt(valve, 0);
    trace_event("OFF channel=%d result=%d", CONFIG_VALVE_TEST_CHANNEL, err);
    return err;
}
```

## src/embedded_sequence.c
```c
/* Named-sequence engine: USB shell and TCP queue work; main owns timed execution.
 * JSON steps become immutable tables in the generated valve_sequence.h. */
#include <errno.h>
#include <string.h>
#include <zephyr/drivers/gpio.h>
#include <zephyr/kernel.h>
#include <zephyr/sys/util.h>
#include "valve_sequence.h"
#include "sequence_engine.h"
#include "test_trace.h"

/* Array indices are the channel numbers used by JSON masks and wire requests. */
static const struct gpio_dt_spec valves[] = {
    DT_FOREACH_PROP_ELEM_SEP(DT_PATH(zephyr_user), valve_gpios,
                             GPIO_DT_SPEC_GET_BY_IDX, (,))
};

BUILD_ASSERT(SEQUENCE_REQUIRED_CHANNELS <= ARRAY_SIZE(valves),
             "Sequence uses a valve channel absent from this board");
BUILD_ASSERT(ARRAY_SIZE(valves) <= 32, "Sequence masks support at most 32 channels");

/* Keep trying every output, even if one write fails. */
static int all_off(void)
{
    int first_error = 0;
    for (size_t i = 0; i < ARRAY_SIZE(valves); ++i) {
        if (!gpio_is_ready_dt(&valves[i])) {
            if (!first_error) {
                first_error = -ENODEV;
            }
            continue;
        }
        int err = gpio_pin_set_dt(&valves[i], 0);
        if (err) {
            trace_event("OFF FAILED channel=%u error=%d", (unsigned)i, err);
        }
        if (err && !first_error) {
            first_error = err;
        }
    }
    return first_error;
}

enum sequence_state { INITIALIZING, READY, RUNNING, COMPLETE, FAULTED, ABORTED };
static enum sequence_state state = INITIALIZING;
static const struct valve_sequence *selected;
/* Serialize command admission and snapshots across main, shell and TCP threads.
 * Semaphores separately queue a run and interrupt a timed step for abort. */
K_MUTEX_DEFINE(state_lock);
K_SEM_DEFINE(run_requested, 0, 1);
K_SEM_DEFINE(abort_wakeup, 0, 1);
static bool aborting;
static uint32_t current_step;
static int last_error;
static uint32_t manual_outputs;

static uint32_t manual_overrides;
static uint32_t sequence_outputs;

/* Caller holds state_lock. A manual OFF is an override too. */
static int apply_outputs(void)
{
    uint32_t effective = (sequence_outputs & ~manual_overrides) |
                         (manual_outputs & manual_overrides);
    for (size_t i = 0; i < ARRAY_SIZE(valves); ++i) {
        int err = gpio_pin_set_dt(&valves[i], !!(effective & BIT(i)));
        if ((effective & BIT(i)) || err) {
            trace_event("GPIO channel=%u requested=%u result=%d raw_readback=%d",
                        (unsigned)i, (unsigned)!!(effective & BIT(i)), err,
                        gpio_pin_get_raw(valves[i].port, valves[i].pin));
        }
        if (err) {
            sequence_outputs = manual_overrides = manual_outputs = 0;
            int off_err = all_off();
            trace_event("FAULT cleanup OFF result=%d", off_err);
            last_error = err;
            state = FAULTED;
            return err;
        }
    }
    trace_event("OUTPUT sequence=0x%08x overrides=0x%08x manual=0x%08x effective=0x%08x",
                (unsigned)sequence_outputs, (unsigned)manual_overrides,
                (unsigned)manual_outputs, (unsigned)effective);
    return 0;
}

int sequence_manual_control(uint32_t channel, bool powered, bool release)
{
    if (channel >= ARRAY_SIZE(valves)) return -EINVAL;
    k_mutex_lock(&state_lock, K_FOREVER);
    if (state == RUNNING) {
        k_mutex_unlock(&state_lock);
        return -EACCES;
    }
    if (state == INITIALIZING || state == FAULTED) {
        k_mutex_unlock(&state_lock);
        return -EBUSY;
    }
    if (release) {
        manual_overrides &= ~BIT(channel);
        manual_outputs &= ~BIT(channel);
    } else {
        manual_overrides |= BIT(channel);
        if (powered) manual_outputs |= BIT(channel);
        else manual_outputs &= ~BIT(channel);
    }
    bool running = state == RUNNING;
    int err = apply_outputs();
    if (err && running) k_sem_give(&abort_wakeup);
    trace_event("MANUAL channel=%u power=%s release=%u result=%d", (unsigned)channel,
                powered ? "ON" : "OFF", (unsigned)release, err);
    k_mutex_unlock(&state_lock);
    return err;
}

int sequence_manual_valve(uint32_t channel, bool powered)
{
    return sequence_manual_control(channel, powered, false);
}

size_t sequence_count(void) { return ARRAY_SIZE(sequences); }
const char *sequence_name(size_t index) { return index < sequence_count() ? sequences[index].name : NULL; }

struct sequence_snapshot sequence_status(void)
{
    static const char *const names[] = {"initializing", "ready", "running", "complete", "faulted", "aborted"};
    k_mutex_lock(&state_lock, K_FOREVER);
    /* Strings point to static tables; copy related counters under the same lock. */
    struct sequence_snapshot out = {
        .state = aborting && state == RUNNING ? "aborting" : names[state],
        .name = selected ? selected->name : "",
        .comment = selected && current_step ? selected->steps[current_step - 1].comment : "",
        .step = current_step,
        .total_steps = selected ? selected->count : 0,
        .error = last_error,
        .manual_powered_channels = manual_outputs,
        .manual_override_channels = manual_overrides,
        .sequence_requested_channels = sequence_outputs,
    };
    /* Read logical GPIO state for manual and sequence outputs alike. */
    for (size_t i = 0; i < ARRAY_SIZE(valves); ++i) {
        if (state == INITIALIZING || !gpio_is_ready_dt(&valves[i])) {
            continue;
        }
        int raw = gpio_pin_get_raw(valves[i].port, valves[i].pin);
        if (raw >= 0) {
            out.known_channels |= BIT(i);
            if (!!raw ^ !!(valves[i].dt_flags & GPIO_ACTIVE_LOW)) {
                out.powered_channels |= BIT(i);
            }
        }
    }
    k_mutex_unlock(&state_lock);
    return out;
}

int sequence_abort(void)
{
    k_mutex_lock(&state_lock, K_FOREVER);
    int err = 0;
    if (state == INITIALIZING) {
        err = -EBUSY;
    } else {
        bool running = state == RUNNING;
        sequence_outputs = manual_overrides = manual_outputs = 0;
        err = all_off();
        if (err) {
            last_error = err;
            state = FAULTED;
        } else if (!running && state != FAULTED) {
            state = ABORTED;
        }
        if (running) {
            aborting = true;
            k_sem_give(&abort_wakeup);
        }
    }
    k_mutex_unlock(&state_lock);
    return err;
}

static int run_sequence(const struct valve_sequence *sequence)
{
    trace_event("START sequence=%s", sequence->name);
    for (size_t step = 0; step < sequence->count; ++step) {
        k_mutex_lock(&state_lock, K_FOREVER);
        if (aborting || state == FAULTED) {
            int err = last_error;
            k_mutex_unlock(&state_lock);
            return err;
        }
        /* Expose one-based progress before energizing this step; zero means queued. */
        current_step = step + 1;
        if (sequence->steps[step].comment[0]) {
            trace_event("NEXT: %s", sequence->steps[step].comment);
        }
        trace_event("STEP %u/%u mask=0x%08x duration=%u ms",
                    (unsigned)step + 1, (unsigned)sequence->count,
                    (unsigned)sequence->steps[step].mask,
                    (unsigned)sequence->steps[step].duration_ms);
        uint32_t controlled = sequence->steps[step].mask | sequence->steps[step].off_mask;
        manual_overrides &= ~controlled;
        manual_outputs &= ~controlled;
        sequence_outputs = sequence->steps[step].mask;
        int err = apply_outputs();
        k_mutex_unlock(&state_lock);
        if (!err) {
            k_sem_take(&abort_wakeup, K_MSEC(sequence->steps[step].duration_ms));
        }
        k_mutex_lock(&state_lock, K_FOREVER);
        /* Keep continuously requested valves on across adjacent steps. */
        sequence_outputs &= step + 1 < sequence->count && !aborting
                            ? sequence->steps[step + 1].mask : 0;
        int off_err = state == FAULTED ? last_error : apply_outputs();
        bool cancelled = aborting;
        k_mutex_unlock(&state_lock);
        trace_event("STEP %u OFF result=%d", (unsigned)step + 1, off_err);
        if (err || off_err) return err ? err : off_err;
        if (cancelled) {
            trace_event("ABORTED: all outputs commanded inactive");
            return 0;
        }
    }
    trace_event("COMPLETE: sequence outputs cleared; manual overrides retained");
    return 0;
}

static int cmd_list(const struct shell *sh, size_t argc, char **argv)
{
    ARG_UNUSED(argc);
    ARG_UNUSED(argv);
    for (size_t i = 0; i < ARRAY_SIZE(sequences); ++i) {
        shell_print(sh, "%s (%u steps)", sequences[i].name, (unsigned)sequences[i].count);
    }
    return 0;
}

static int cmd_status(const struct shell *sh, size_t argc, char **argv)
{
    ARG_UNUSED(argc);
    ARG_UNUSED(argv);
    struct sequence_snapshot status = sequence_status();
    shell_print(sh, "%s; sequence=%s step=%u/%u error=%d comment=%s", status.state,
                status.name, (unsigned)status.step, (unsigned)status.total_steps,
                status.error, status.comment);
    return 0;
}

int sequence_start(const char *name)
{
    const struct valve_sequence *sequence = NULL;
    for (size_t i = 0; i < ARRAY_SIZE(sequences); ++i) {
        if (!strcmp(name, sequences[i].name)) {
            sequence = &sequences[i];
            break;
        }
    }
    if (!sequence) {
        return -ENOENT;
    }
    k_mutex_lock(&state_lock, K_FOREVER);
    /* Lock out manual commands as soon as the run is accepted. */
    if (state == INITIALIZING || state == RUNNING || state == FAULTED) {
        k_mutex_unlock(&state_lock);
        return -EBUSY;
    }
    selected = sequence;
    state = RUNNING;
    aborting = false;
    current_step = 0;
    last_error = 0;
    /* Discard an earlier run's wakeup before accepting this run's abort requests. */
    k_sem_reset(&abort_wakeup);
    /* Publish selection and wakeup together so USB/TCP starts cannot race. */
    k_sem_give(&run_requested);
    k_mutex_unlock(&state_lock);
    return 0;
}

static int cmd_run(const struct shell *sh, size_t argc, char **argv)
{
    ARG_UNUSED(argc);
    int err = sequence_start(argv[1]);
    if (err) {
        shell_error(sh, "Cannot start (%d): check name/status; faults require reset", err);
    } else {
        shell_print(sh, "Queued sequence %s", argv[1]);
    }
    return err;
}

static int cmd_abort(const struct shell *sh, size_t argc, char **argv)
{
    ARG_UNUSED(argc);
    ARG_UNUSED(argv);
    int err = sequence_abort();
    if (err) {
        shell_error(sh, "Abort failed (%d); check sequence status", err);
        return err;
    }
    shell_print(sh, "Abort requested; use sequence status to confirm outputs-off completion");
    return 0;
}

SHELL_STATIC_SUBCMD_SET_CREATE(sequence_commands,
    SHELL_CMD_ARG(list, NULL, "List embedded sequences", cmd_list, 1, 0),
    SHELL_CMD_ARG(run, NULL, "Run a named sequence", cmd_run, 2, 0),
    SHELL_CMD_ARG(status, NULL, "Show sequence state", cmd_status, 1, 0),
    SHELL_CMD_ARG(abort, NULL, "Abort and deactivate outputs", cmd_abort, 1, 0),
    SHELL_SUBCMD_SET_END
);
SHELL_CMD_REGISTER(sequence, &sequence_commands, "Embedded valve sequences", NULL);

int main(void)
{
    trace_start("named embedded sequences (manual start)");
    trace_event("Initializing %u GPIO channels", (unsigned)ARRAY_SIZE(valves));
    bool ready = true;
    for (size_t i = 0; i < ARRAY_SIZE(valves); ++i) {
        const struct gpio_dt_spec *pin = &valves[i];
        int err = gpio_is_ready_dt(pin) ?
            gpio_pin_configure_dt(pin, GPIO_OUTPUT_INACTIVE) : -ENODEV;
        trace_event("INIT channel=%u port=%s pin=%u active_%s result=%d",
                    (unsigned)i, pin->port->name, pin->pin,
                    pin->dt_flags & GPIO_ACTIVE_LOW ? "low" : "high", err);
        if (err) {
            ready = false;
        }
    }
    if (!ready) {
        trace_event("STOP: GPIO initialization failed; sequence will not run");
        all_off();
        k_mutex_lock(&state_lock, K_FOREVER);
        state = FAULTED;
        last_error = -ENODEV;
        k_mutex_unlock(&state_lock);
        return -ENODEV;
    }

    k_mutex_lock(&state_lock, K_FOREVER);
    state = READY;
    k_mutex_unlock(&state_lock);
    trace_event("READY: use sequence list, then sequence run <name>");
    for (;;) {
        k_sem_take(&run_requested, K_FOREVER);
        /* RUNNING prevents USB/TCP commands from changing selected during a run. */
        int err = run_sequence(selected);
        k_mutex_lock(&state_lock, K_FOREVER);
        if (state == FAULTED && !err) err = last_error;
        last_error = err;
        /* Faults take precedence over abort/completion and block subsequent starts. */
        state = last_error ? FAULTED : (aborting ? ABORTED : COMPLETE);
        k_mutex_unlock(&state_lock);
        trace_event("State=%s", sequence_status().state);
    }
}
```

## src/sequence_engine.h
```c
#pragma once
#include <stddef.h>
#include <stdint.h>
#include <stdbool.h>

/* Snapshot strings refer to static storage; step is one-based, or zero before start.
 * The manual mask records successful commands, not electrical feedback. */
struct sequence_snapshot {
    const char *state;
    const char *name;
    const char *comment;
    uint32_t step;
    uint32_t total_steps;
    int error;
    uint32_t manual_override_channels;
    uint32_t sequence_requested_channels;
    uint32_t manual_powered_channels;
    uint32_t powered_channels;
    uint32_t known_channels;
};

size_t sequence_count(void);
const char *sequence_name(size_t index);
/* Start queues asynchronous work; abort may return before running-step cleanup.
 * GPIO faults remain latched until firmware restart. */
int sequence_start(const char *name);
int sequence_abort(void);
/* ON and OFF persist as overrides; release resumes sequence control. */
int sequence_manual_control(uint32_t channel, bool powered, bool release);
int sequence_manual_valve(uint32_t channel, bool powered);
struct sequence_snapshot sequence_status(void);
```

## src/sequence_protocol.c
```c
#include <errno.h>
#include <stdio.h>
#include <string.h>
#include "sequence_engine.h"
#include "sequence_protocol.h"

/* Shared adapter from wire operations to the same engine used by the USB shell. */
void sequence_handle_request(const Request *request, Response *response)
{
    /* Responses are reused by the server; clear optional-field flags on every call. */
    *response = (Response)Response_init_zero;
    bool manual = request->which_payload == Request_manual_valve_tag;
    bool abort = request->which_payload == Request_abort_tag;
    if (!abort && !manual && request->which_payload != Request_named_sequence_tag) {
        response->has_err = true;
        snprintf(response->err, sizeof(response->err),
                 "Standalone valve test supports named_sequence, manual_valve and abort only");
        return;
    }
    const NamedSequenceRequest *command = &request->payload.named_sequence;
    int err = 0;
    if (manual) {
        err = sequence_manual_control(request->payload.manual_valve.channel,
                                      request->payload.manual_valve.powered,
                                      request->payload.manual_valve.release);
    } else if (abort) {
        err = sequence_abort();
    } else switch (command->operation) {
    case NamedSequenceRequest_Operation_LIST:
    case NamedSequenceRequest_Operation_STATUS:
        break;
    case NamedSequenceRequest_Operation_RUN:
        err = command->has_name && command->name[0] ? sequence_start(command->name) : -EINVAL;
        break;
    case NamedSequenceRequest_Operation_STOP:
        err = sequence_abort(); /* Legacy wire operation; new clients send AbortRequest. */
        break;
    default:
        err = -EINVAL;
        break;
    }
    if (err) {
        response->has_err = true;
        if (manual && err == -EACCES) {
            snprintf(response->err, sizeof(response->err),
                     "MANUAL CONTROL BLOCKED: sequence running; wait or abort");
        } else {
            snprintf(response->err, sizeof(response->err),
                     "Valve/sequence request rejected (%d): check channel, name and status; faults require reset", err);
        }
    }
    /* Report a coherent engine snapshot after command acceptance, not run completion. */
    struct sequence_snapshot status = sequence_status();
    response->has_named_sequence = true;
    NamedSequenceInfo *info = &response->named_sequence;
    snprintf(info->state, sizeof(info->state), "%s", status.state);
    info->has_name = true;
    snprintf(info->name, sizeof(info->name), "%s", status.name);
    info->has_comment = true;
    snprintf(info->comment, sizeof(info->comment), "%s", status.comment);
    info->has_step = info->has_total_steps = info->has_error = true;
    info->step = status.step;
    info->total_steps = status.total_steps;
    info->error = status.error;
    info->has_powered_channels = info->has_known_channels = true;
    info->powered_channels = status.powered_channels;
    info->known_channels = status.known_channels;
    info->has_manual_powered_channels = true;
    info->manual_powered_channels = status.manual_powered_channels;
    info->has_manual_override_channels = true;
    info->manual_override_channels = status.manual_override_channels;
    info->has_sequence_requested_channels = true;
    info->sequence_requested_channels = status.sequence_requested_channels;
    if (!abort && !manual && command->operation == NamedSequenceRequest_Operation_LIST) {
        for (size_t i = 0; i < sequence_count(); ++i) {
            snprintf(info->names[info->names_count++], sizeof(info->names[0]), "%s", sequence_name(i));
        }
    }
}
```

## src/sequence_protocol.h
```c
#pragma once
#include "clover.pb.h"

/* Same Request/Response and length-delimited framing as Clover's TCP server. */
void sequence_handle_request(const Request *request, Response *response);
```

## src/sequence_server.c
```c
/* Clover-compatible transport only; sequence_protocol dispatches commands and
 * embedded_sequence owns GPIO timing independently of client connections. */
#include <errno.h>
#include <string.h>
#include <pb_decode.h>
#include <pb_encode.h>
#include <zephyr/kernel.h>
#include <zephyr/logging/log.h>
#include <zephyr/net/socket.h>
#include "sequence_protocol.h"

LOG_MODULE_REGISTER(sequence_tcp, LOG_LEVEL_INF);

#define CLIENTS 2
#define FRAME_SIZE 256
#define PARTIAL_TIMEOUT_MS 5000
/* Retain partial prefix/body state independently for each connected client. */
struct client {
    uint8_t frame[FRAME_SIZE];
    size_t used;
    uint32_t length;
    unsigned prefix_bytes;
    bool reading_body;
    int64_t last_byte;
};

static void serve(void *a, void *b, void *c)
{
    ARG_UNUSED(a); ARG_UNUSED(b); ARG_UNUSED(c);
    static struct client clients[CLIENTS];
    /* Large protobuf unions and wire buffers live off the thread stack. */
    static Request request;
    static Response response;
    static uint8_t reply[3072];
    struct zsock_pollfd fds[CLIENTS + 1];
    for (size_t i = 0; i < ARRAY_SIZE(fds); ++i) {
        fds[i] = (struct zsock_pollfd){.fd = -1, .events = ZSOCK_POLLIN};
    }
    struct sockaddr_in address = {
        .sin_family = AF_INET,
        .sin_port = htons(19690),
        .sin_addr.s_addr = INADDR_ANY,
    };
    int listener = zsock_socket(AF_INET, SOCK_STREAM, IPPROTO_TCP);
    if (listener < 0 || zsock_bind(listener, (struct sockaddr *)&address, sizeof(address)) < 0 ||
        zsock_listen(listener, CLIENTS) < 0) {
        LOG_ERR("Cannot start TCP port 19690: errno=%d", errno);
        if (listener >= 0) zsock_close(listener);
        return;
    }
    fds[0].fd = listener;
    LOG_INF("Sequence TCP server ready on port 19690");
    for (;;) {
        int result = zsock_poll(fds, ARRAY_SIZE(fds), 100);
        if (result < 0) {
            if (errno == EINTR) continue;
            LOG_ERR("TCP poll failed: errno=%d", errno);
            break;
        }
        if (fds[0].revents & ZSOCK_POLLIN) {
            int fd = zsock_accept(listener, NULL, NULL);
            if (fd >= 0) {
                size_t slot;
                for (slot = 1; slot <= CLIENTS; ++slot) {
                    if (fds[slot].fd < 0) {
                        fds[slot].fd = fd;
                        memset(&clients[slot - 1], 0, sizeof(clients[0]));
                        /* Bound slow-reader stalls in this shared server thread. */
                        struct timeval timeout = {.tv_sec = 0, .tv_usec = 100000};
                        zsock_setsockopt(fd, SOL_SOCKET, SO_SNDTIMEO, &timeout, sizeof(timeout));
                        break;
                    }
                }
                if (slot > CLIENTS) zsock_close(fd);
            }
        }
        for (size_t i = 1; i <= CLIENTS; ++i) {
            if (fds[i].fd < 0) continue;
            struct client *client = &clients[i - 1];
            bool close_client = fds[i].revents & (ZSOCK_POLLERR | ZSOCK_POLLHUP | ZSOCK_POLLNVAL);
            if ((client->prefix_bytes || client->reading_body) &&
                k_uptime_get() - client->last_byte > PARTIAL_TIMEOUT_MS) close_client = true;
            /* Consume one byte per poll iteration; partial clients cannot block others. */
            if (!close_client && (fds[i].revents & ZSOCK_POLLIN)) {
                uint8_t byte;
                if (zsock_recv(fds[i].fd, &byte, 1, 0) != 1) {
                    close_client = true;
                } else {
                    client->last_byte = k_uptime_get();
                    if (!client->reading_body) {
                        /* Reject oversized varints before shifting or indexing frame storage. */
                        if (client->prefix_bytes == 4 ||
                            (client->prefix_bytes == 3 && (byte & 0xf0))) {
                            close_client = true;
                        } else {
                            client->length |= (uint32_t)(byte & 0x7f) << (7 * client->prefix_bytes++);
                            if (!(byte & 0x80)) {
                                client->reading_body = true;
                                if (!client->length || client->length > FRAME_SIZE) close_client = true;
                            }
                        }
                    } else {
                        client->frame[client->used++] = byte;
                        if (client->used == client->length) {
                            request = (Request)Request_init_zero;
                            pb_istream_t input = pb_istream_from_buffer(client->frame, client->length);
                            if (!pb_decode(&input, Request_fields, &request)) {
                                close_client = true;
                            } else {
                                /* Dispatch once per complete frame. Losing the reply does not
                                 * undo a run/manual command already accepted by the engine. */
                                sequence_handle_request(&request, &response);
                                pb_ostream_t output = pb_ostream_from_buffer(reply, sizeof(reply));
                                if (!pb_encode_delimited(&output, Response_fields, &response)) {
                                    close_client = true;
                                } else {
                                    size_t sent = 0;
                                    while (sent < output.bytes_written) {
                                        int count = zsock_send(fds[i].fd, reply + sent, output.bytes_written - sent, 0);
                                        if (count <= 0) { close_client = true; break; }
                                        sent += count;
                                    }
                                }
                            }
                            /* The next byte on this connection begins a new length prefix. */
                            memset(client, 0, sizeof(*client));
                        }
                    }
                }
            }
            if (close_client) {
                zsock_close(fds[i].fd);
                fds[i].fd = -1;
                memset(client, 0, sizeof(*client));
            }
        }
    }
    for (size_t i = 0; i < ARRAY_SIZE(fds); ++i) {
        if (fds[i].fd >= 0) zsock_close(fds[i].fd);
    }
}

K_THREAD_DEFINE(sequence_server_thread, 4096, serve, NULL, NULL, NULL, 7, 0, 0);
```

## src/test_trace.h
```c
#pragma once

#include <stdarg.h>
#include <stdio.h>
#include <zephyr/kernel.h>
#include <zephyr/logging/log.h>
#include <zephyr/shell/shell.h>
#include <zephyr/usb/usb_device.h>

LOG_MODULE_REGISTER(valve_test, LOG_LEVEL_INF);

/* Keep recent events so connecting after boot does not lose the diagnosis. */
#define TRACE_COUNT 128
static char trace_lines[TRACE_COUNT][160];
static unsigned int trace_total;
K_MUTEX_DEFINE(trace_lock);

static void trace_event(const char *format, ...)
{
    char message[128];
    va_list args;
    va_start(args, format);
    vsnprintf(message, sizeof(message), format, args);
    va_end(args);
    k_mutex_lock(&trace_lock, K_FOREVER);
    snprintf(trace_lines[trace_total % TRACE_COUNT], sizeof(trace_lines[0]),
             "[%lld ms] %s", (long long)k_uptime_get(), message);
    ++trace_total;
    k_mutex_unlock(&trace_lock);
    LOG_INF("%s", message);
}

static int cmd_trace(const struct shell *sh, size_t argc, char **argv)
{
    ARG_UNUSED(argc);
    ARG_UNUSED(argv);
    k_mutex_lock(&trace_lock, K_FOREVER);
    /* Walk logical event numbers so wrapped ring entries print oldest first. */
    unsigned int start = trace_total > TRACE_COUNT ? trace_total - TRACE_COUNT : 0;
    shell_print(sh, "Retained events %u..%u (latest %u maximum)", start, trace_total, TRACE_COUNT);
    for (unsigned int i = start; i < trace_total; ++i) {
        shell_print(sh, "%s", trace_lines[i % TRACE_COUNT]);
    }
    k_mutex_unlock(&trace_lock);
    return 0;
}
SHELL_CMD_REGISTER(trace, NULL, "Show retained valve execution trace", cmd_trace);

static void trace_start(const char *mode)
{
    int err = usb_enable(NULL);
    trace_event("Mode=%s; USB enable result=%d", mode, err);
}
```
