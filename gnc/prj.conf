## CMakeLists.txt
```
cmake_minimum_required(VERSION 3.13.1)
find_package(Zephyr REQUIRED HINTS $ENV{ZEPHYR_BASE})

# For god's sake, why isn't this set automatically?
set(CMAKE_CPP_COMPILER "${CROSS_COMPILE}g++")

message(STATUS "C compiler: ${CMAKE_C_COMPILER}")
message(STATUS "C++ compiler: ${CMAKE_CPP_COMPILER}")

project(app)

# Add nanopb dependency
list(APPEND CMAKE_MODULE_PATH ${ZEPHYR_BASE}/modules/nanopb)
include(nanopb)


zephyr_include_directories(${CMAKE_CURRENT_BINARY_DIR})
zephyr_nanopb_sources(app ../api/gnc.proto)

add_subdirectory(src)
```

## Kconfig
```
# Copyright (c) 2021 Nordic Semiconductor ASA
# SPDX-License-Identifier: Apache-2.0
#
# This file is the application Kconfig entry point. All application Kconfig
# options can be defined here or included via other application Kconfig files.
# You can browse these options using the west targets menuconfig (terminal) or
# guiconfig (GUI).

menu "Zephyr"
source "Kconfig.zephyr"
endmenu

module = THROTTLE
module-str = THROTTLE
source "subsys/logging/Kconfig.template.log_config"


config ARDUINO_API
	bool "ARDUINO_API"
	imply CPP
	imply GPIO
	imply I2C
	imply NEWLIB_LIBC_FLOAT_PRINTF
	imply CBPRINTF_FP_SUPPORT
	imply RING_BUFFER
	select UART_INTERRUPT_DRIVEN
	default n

if ARDUINO_API

config QEMU_ICOUNT
	bool "QEMU icount mode"
	default n
	depends on QEMU_TARGET

config ARDUINO_API_SERIAL_BUFFER_SIZE
	int "Buffer size for Arduino Serial API"
	default 64

config ARDUINO_ENTRY
	bool "Provide arduino setup and loop entry points"
	default n

endif
```

## prj.conf
```kconfig
# Set the following if you're connected directly via ethernet.
# CONFIG_NET_CONFIG_MY_IPV4_ADDR="169.254.99.99"
# CONFIG_NET_CONFIG_MY_IPV4_NETMASK="255.255.0.0"

# Set the following if you're connected via the DAQ box router.
CONFIG_NET_CONFIG_MY_IPV4_ADDR="192.168.0.150"
CONFIG_NET_CONFIG_MY_IPV4_NETMASK="255.255.255.0"

CONFIG_NET_CONFIG_MY_IPV4_GW="192.168.0.1"

CONFIG_CPP=y
CONFIG_STD_CPP2B=y  # Applies std=C++23
CONFIG_SENSOR=y
CONFIG_BLINK=y
CONFIG_LOG_MODE_IMMEDIATE=y
CONFIG_REQUIRES_FULL_LIBC=y
CONFIG_GLIBCXX_LIBCPP=y
CONFIG_NEWLIB_LIBC=y
CONFIG_CBPRINTF_LIBC_SUBSTS=y


CONFIG_TIMESLICING=y
CONFIG_TIMESLICE_SIZE=10
CONFIG_TIMESLICE_PRIORITY=5

CONFIG_NETWORKING=y
CONFIG_NET_UDP=n
CONFIG_NET_TCP=y
CONFIG_NET_IPV4=y
CONFIG_INIT_STACKS=y
CONFIG_NET_LOG=y
CONFIG_NET_CONFIG_SETTINGS=y
CONFIG_NET_CONFIG_NEED_IPV4=y
CONFIG_NET_L2_ETHERNET=y
CONFIG_NET_CONFIG_INIT_TIMEOUT=0
CONFIG_NET_CONTEXT_RCVTIMEO=y
CONFIG_NET_SOCKETS=y
CONFIG_NET_TX_STACK_SIZE=4096
CONFIG_NET_RX_STACK_SIZE=4096
CONFIG_SYSTEM_WORKQUEUE_STACK_SIZE=4096
CONFIG_NET_PKT_RX_COUNT=64
CONFIG_NET_PKT_TX_COUNT=64
CONFIG_NET_BUF_RX_COUNT=64
CONFIG_NET_BUF_TX_COUNT=64
CONFIG_NET_MAX_CONN=64
CONFIG_NET_MAX_CONTEXTS=64
CONFIG_NET_LOG=y
#CONFIG_NET_TCP_LOG_LEVEL_INF=y
#CONFIG_NET_CONTEXT_LOG_LEVEL_INF=y
#CONFIG_NET_SOCKETS_LOG_LEVEL_INF=y
CONFIG_ADC=y
CONFIG_ADC_LOG_LEVEL_WRN=y

# Uncomment to configure a periodic console message of thread CPU/stack usage.
# CONFIG_THREAD_ANALYZER=y
# CONFIG_THREAD_ANALYZER_AUTO=y
# CONFIG_THREAD_ANALYZER_AUTO_INTERVAL=5
# CONFIG_THREAD_NAME=y



CONFIG_NET_CONNECTION_MANAGER=y

CONFIG_NET_TCP_TIME_WAIT_DELAY=0
```

## src/main.cpp
```c
#include <zephyr/kernel.h>
#include <zephyr/logging/log.h>
#include <zephyr/drivers/uart.h>
#include <zephyr/sys/util.h>
#include <zephyr/usb/usb_device.h>
#include <zephyr/net/net_if.h>
#include <zephyr/net/socket.h>
#include <zephyr/net/net_pkt.h>

#include "server.h"
#include "throttle_valve.h"
#include "pts.h"
#include "servotesting.h"


extern "C" {
#include <app/drivers/blink.h>
}

LOG_MODULE_REGISTER(main, CONFIG_LOG_DEFAULT_LEVEL);

BUILD_ASSERT(DT_NODE_HAS_COMPAT(DT_CHOSEN(zephyr_console), zephyr_cdc_acm_uart),
             "Console device is not ACM CDC UART device");

int main(void)
{
    // Status LED
    const struct device* blink = DEVICE_DT_GET(DT_NODELABEL(blink_led));
    if (!device_is_ready(blink)) {
        return 0;
    }
    blink_set_period_ms(blink, 1000u);

    // Serial over USB setup
    if (usb_enable(nullptr)) {
        LOG_ERR("USB is not enabled.");
        while (1) {}
    }

    // Try connecting to serial over usb for 3 seconds.
    const struct device* usb_dev = DEVICE_DT_GET(DT_CHOSEN(zephyr_console));
    for (int i = 0; i < 30; ++i) {
        k_sleep(K_MSEC(100));

        uint32_t dtr = 0;
        uart_line_ctrl_get(usb_dev, UART_LINE_CTRL_DTR, &dtr);
        if (dtr) {
            break;
        }
    }


    LOG_INF("Initializing fuel throttle valve");
    int err = FuelValve::init();
    if (err) {
        LOG_ERR("Failed to initialize fuel throttle valve");
        return 0;
    }

    LOG_INF("Initializing lox throttle valve");
    err = LoxValve::init();
    if (err) {
        LOG_ERR("Failed to initialize lox throttle valve");
        return 0;
    }

    LOG_INF("Initializing PTs");
    err = pts_init();
    if (err) {
        LOG_ERR("Failed to initialize PTs");
        return 0;
    }
    err = servos_init();
    if (err) {
        LOG_ERR("Failed to initialize servos");
        return 0;
    }
    servotesting_demo();
    LOG_INF("Starting server");
    serve_connections();

    while (1) {}
}
```

## src/encoder.cpp
```c
#include "encoder.h"
#include <zephyr/device.h>
#include <zephyr/devicetree.h>
#include <zephyr/drivers/gpio.h>
#include <zephyr/kernel.h>
#include <zephyr/logging/log.h>
#include <cmath>
#include <algorithm>

LOG_MODULE_REGISTER(encoder, CONFIG_LOG_DEFAULT_LEVEL);

#define USER_NODE DT_PATH(zephyr_user)

// Encoder GPIOs from devicetree
static const struct gpio_dt_spec encA = GPIO_DT_SPEC_GET(USER_NODE, encoder_a_gpios);
static const struct gpio_dt_spec encB = GPIO_DT_SPEC_GET(USER_NODE, encoder_b_gpios);

// Mechanical parameters (motor side)
static constexpr float ENCODER_CPR = 4000.0f; // counts per motor revolution (quadrature)
static constexpr float GEAR_RATIO = 5.0f;   // gearbox ratio
static constexpr float DEG_PER_TICK = 360.0f / (ENCODER_CPR * GEAR_RATIO);

// Quad state + position tracking
static volatile uint8_t s_prev_state = 0;
static volatile int32_t s_position = 0;

static struct gpio_callback encA_cb;
static struct gpio_callback encB_cb;

// Read current 2-bit state: bit0 = A, bit1 = B
static inline uint8_t read_state() {
    uint8_t a = gpio_pin_get_dt(&encA);
    uint8_t b = gpio_pin_get_dt(&encB);
    return (b << 1) | a;
}

// Quadrature lookup table
// Standard Gray code order from AMT encoder datasheet:
// forward: 00 → 01 → 11 → 10 → 00
// reverse: 00 → 10 → 11 → 01 → 00 (need this tested as param)
static constexpr int8_t Q_TABLE[4][4] = {
        /*new: 00, 01, 11, 10*/
        /*00*/ {0,  +1, -1, 0},
        /*01*/
               {-1, 0,  0,  +1},
        /*11*/
               {+1, 0,  0,  -1},
        /*10*/
               {0,  -1, +1, 0},
};

// ISR on any edge
static void encoder_gpio_isr(const struct device *, struct gpio_callback *, gpio_port_pins_t) {
    uint8_t new_state = read_state();
    int8_t delta = Q_TABLE[s_prev_state][new_state];

    s_position += delta;
    s_prev_state = new_state;
}

int encoder_init() {
    if (!device_is_ready(encA.port) || !device_is_ready(encB.port)) {
        LOG_ERR("Encoder GPIO not ready");
        return -ENODEV;
    }

    int err = gpio_pin_configure_dt(&encA, GPIO_INPUT);
    if (err) return err;

    err = gpio_pin_configure_dt(&encB, GPIO_INPUT);
    if (err) return err;

    // load initial 2-bit state
    s_prev_state = read_state();

    // interrupts on both channels
    err = gpio_pin_interrupt_configure_dt(&encA, GPIO_INT_EDGE_BOTH);
    if (err) return err;

    err = gpio_pin_interrupt_configure_dt(&encB, GPIO_INT_EDGE_BOTH);
    if (err) return err;

    // Zephyr DT-based callback registration
    gpio_init_callback(&encA_cb, encoder_gpio_isr, BIT(encA.pin));
    gpio_add_callback_dt(&encA, &encA_cb);

    gpio_init_callback(&encB_cb, encoder_gpio_isr, BIT(encB.pin));
    gpio_add_callback_dt(&encB, &encB_cb);

    LOG_INF("Encoder initialized (4-state quadrature)");
    return 0;
}

int32_t encoder_get_position() {
    return s_position;
}

float encoder_get_degrees() {
    return static_cast<float>(s_position) * DEG_PER_TICK;
}

void encoder_reset_pos(float pos) {
    s_position = static_cast<float>(std::round(pos / DEG_PER_TICK));
}
```

## src/encoder.h
```c
#ifndef CLOVER_ENCODER_H
#define CLOVER_ENCODER_H

#include <cstdint>

// Initialize quadrature encoder GPIO + interrupts
// Returns 0 on success, negative error code on failure
int encoder_init();

// Get current encoder position in ticks (signed, relative to boot)
int32_t encoder_get_position();

// Get corresponding output-shaft angle in degrees
float encoder_get_degrees();

// Set the current encoder position without moving anything. In degrees.
void encoder_reset_pos(float pos);

#endif // CLOVER_ENCODER_H
```

## src/flightcontrol.cpp
```c
#include "flightcontrol.h"

LOG_MODULE_REGISTER(flightcontrol, CONFIG_LOG_DEFAULT_LEVEL);

// ---------- Constants ----------

const float maxThrottleN = 2.5; // newtons
const float maxGimble = 12.0;   // degrees
const float maxTiltDeg = 15.0;  // What we dont want the rocket to tilt more than (deg)
const float angleXNeutral = 54.0f;
const float angleYNeutral = -18.0f;
const double loopFreq = 100.0; // Hz
constexpr float DEG2RAD_F = 0.0174532925f;

// Mounting offset between IMU sensor frame and rocket body frame (deg)
constexpr float SENSOR_TO_BODY_YAW_DEG = 45.0f;
constexpr float SENSOR_TO_BODY_PITCH_DEG = -90.0f;
constexpr float SENSOR_TO_BODY_ROLL_DEG = 0.0f;

PID pidRoll(0.8, 0.1, 0.0);  // needs tuning
PID pidPitch(0.8, 0.1, 0.0); // needs tuning
PID pidHeading(0, 0, 0);     // needs tuning
PID pidX(0, 0, 0);           // needs tuning
PID pidY(0, 0, 0);           // needs tuning
PID pidZ(0, 0, 0);           // needs tuning
PID pidZVelocity(0, 0, 0);   // needs tuning
// ---------- Simple runtime state ----------

struct Ref
{
    float yaw0{0}, pitch0{0}, roll0{0};
    float x0{0}, y0{0}, z0{0};
    bool set{false};
} ref;

struct State
{
    float pitch{0}, roll{0};
    float heading{0}, tiltX{0}, tiltY{0};
    float x{0}, y{0}, z{0};
    float xVel{0}, yVel{0}, zVel{0};
} state;

struct desState
{
    float pitch{0}, roll{0};
    float heading{0}, tiltX{0}, tiltY{0};
    float x{0}, y{0}, z{0};
    float zVel{0};
} desState;

// ---------- Global state ----------

double loopTime = 0.0;
double prevIMUTimestampUs = 0.0;
int loopCount = 0;
bool stopped = false;

// ---------- Main program ----------

// Utility that doesn’t belong to a single device: basic centering & neutralization
void centerTVC()
{
    set_desired_thrust_deg(0,0);

}

int flight_init()
{

    int err = servos_init();
    if (err){
        LOG_ERR("Failed to initialize servos");
        return 1;
    }
    // Bring servos to neutral
    centerTVC();

    err = esc_init();
    if (err){
        LOG_ERR("Failed to initialize esc's");
        return 1;
    }

    // IMU: TBD, reference OldDrone code


    pidRoll.setIntegralLimits(-maxGimble / 3, maxGimble / 3);
    pidPitch.setIntegralLimits(-maxGimble / 3, maxGimble / 3);

    return 0;
}

// returns {xOutput, yOutput} for thrust angles
std::array<float, 2> rotationalPID(float dt)
{
    // Compute PID outputs
    std::array<float, 2> out{};
    out[0] = pidRoll.calculate(desState.roll, state.roll, dt);
    out[1] = pidPitch.calculate(desState.pitch, state.pitch, dt);

    return out;
}

// returns {xOutput, yOutput} for thruster angles
std::array<float, 2> lateralPID(float dt)
{
    // outerloop on position
    if (loopCount % 3 == 0)
    {
        // Compute desired tilt in world frame
        desState.tiltX = pidX.calculate(desState.x, 0, dt);
        desState.tiltY = pidY.calculate(desState.y, 0, dt);

        // Rotate desired tilt from world frame to body frame
        const float headingRad = state.heading * DEG2RAD_F;
        desState.roll = cosf(headingRad) * desState.tiltX + sinf(headingRad) * desState.tiltY;
        desState.pitch = -sinf(headingRad) * desState.tiltX + cosf(headingRad) * desState.tiltY;
        desState.roll = util::clamp(desState.roll, -maxGimble, +maxGimble);
        desState.pitch = util::clamp(desState.pitch, -maxGimble, +maxGimble);
    }
    // innerloop on rotation
    return rotationalPID(dt);
}

// returns desired throttle in newtons
float verticalPID(float dt)
{
    // outerloop on position
    if (loopCount % 3 == 0)
    {
        desState.zVel = pidZ.calculate(desState.z, 0, dt);
    }
    // innerloop on velocity
    float desThrottle = pidZVelocity.calculate(desState.zVel, 0, dt);
    return util::clamp(desThrottle, 0.0f, 1.0f);
}

// returns a desired constant, -1..1 to add to ESC 1, subtract from ESC 2
float headingPID(float dt)
{
    float headingError = desState.heading - state.heading;
    if (headingError > 180.0f)
        headingError -= 360.0f;
    if (headingError < -180.0f)
        headingError += 360.0f;

    float out = pidHeading.calculate(0.0f, -headingError, dt); // negative error maybe?
    return out;
}

void updateState()
{

    //auto e = imu.euler();
    //state.pitch = e.pitch - ref.pitch0;
    //state.roll = e.roll - ref.roll0;

    //auto a = imu.projectedAngles();
    //state.tiltX = a.tiltAboutX;
    //state.tiltY = a.tiltAboutY;
   // state.heading = a.heading;

    // MEKF data for position and rates

    // auto la = imu.accelerometer();
    // state.xAcc = la.x;
    // state.yAcc = la.y;
    // state.zAcc = la.z;
}
// dt = milliseconds since last loop

int flight_control_loop_step(double dt)
{
    LOG_INF("Got delta time: ");
    LOG_INF(dt);


    if (stopped)
    {
        esc_idle();
        centerTVC();
        return 1;
    }

    //imu.update();
    // // Refresh IMU data
    updateState();

    // get desired thrust angles
    std::array<float, 2> pidOut = lateralPID(dt); // level flight at origin

    // send input to servos
    set_desired_thrust_deg(pidOut[0], pidOut[1]);

    // get base throttle
    float throttle01= verticalPID(dt);

    // calculate yaw correction
    float yawAdjust = headingPID(dt);
    float throttle01a = util::clamp(throttle01 + yawAdjust, 0.0f, 1.0f);
    float throttle01b = util::clamp(throttle01 - yawAdjust, 0.0f, 1.0f);

    // send input to ESC's'
    set_desired_thrust_newtons(throttle01a * maxThrottleN,throttle01b * maxThrottleN, maxThrottleN);

    loopCount++;
    LOG_INF("loop count completed: ");
    LOG_INF(loopCount);
    LOG_INF("\n");

    return 0;
}


void flight_stop(){
    stopped = true;
}
```

## src/flightcontrol.h
```c
//
// Created by lpl on 11/17/25.
//

#ifndef CLOVER_FLIGHTCONTROL_H
#define CLOVER_FLIGHTCONTROL_H

#include <array>
#include <zephyr/logging/log.h>
#include "util/math.h"
#include "util/pid.h"
#include "hornet_tvc.h"

void centerTVC();

int flight_init();
std::array<float, 2> rotationalPID(float dt);
std::array<float, 2> lateralPID(float dt);
float verticalPID(float dt);
float headingPID(float dt);
void updateState();

int flight_control_loop_step(double dt);
void flight_stop();


#endif //CLOVER_FLIGHTCONTROL_H
```

## src/hornet_tvc.cpp
```c
#include "hornet_tvc.h"


#define ZEPHYR_USER_NODE DT_PATH(zephyr_user)

LOG_MODULE_REGISTER(hornet_tvc, CONFIG_LOG_DEFAULT_LEVEL);


// start with 1000-2000 us PWM signal, test to go up to 500-2500
static const pwm_dt_spec SERVO_X =
    PWM_DT_SPEC_GET_BY_NAME(DT_PATH(zephyr_user), tvc_x);
static const pwm_dt_spec SERVO_Y =
    PWM_DT_SPEC_GET_BY_NAME(DT_PATH(zephyr_user), tvc_y);

static const pwm_dt_spec ESC_1 =
    PWM_DT_SPEC_GET_BY_NAME(DT_PATH(zephyr_user), esc_1);
static const pwm_dt_spec ESC_2 =
    PWM_DT_SPEC_GET_BY_NAME(DT_PATH(zephyr_user), esc_2);



static inline bool pwm_ready(const pwm_dt_spec& s) {
    return device_is_ready(s.dev);
}

/* Initialize: verify all PWM endpoints are present & ready */
int servos_init() {
    if (
        !pwm_ready(SERVO_X) || !pwm_ready(SERVO_Y)) {
        return -ENODEV;
    }
    /* Optional: park outputs at neutral pulses if your PCA9685 default is 0 */
    pwm_set_pulse_dt(&SERVO_X, PWM_USEC(1500));
    pwm_set_pulse_dt(&SERVO_Y, PWM_USEC(1500));
    pwm_set_pulse_dt(&ESC_1,  PWM_USEC(1000));
    pwm_set_pulse_dt(&ESC_2,  PWM_USEC(1000));
    return 0;
}

int esc_init() {
    if (
        !pwm_ready(ESC_1) || !pwm_ready(ESC_2) ){
        return -ENODEV;
    }
    pwm_set_pulse_dt(&ESC_1,  PWM_USEC(1000));
    pwm_set_pulse_dt(&ESC_2,  PWM_USEC(1000));
    return 0;
}

// To be set later with 4-bar geometry and imu transformations, look at old drone code for reference
int set_desired_thrust_deg(double thrust_deg_x, double thrust_deg_y) {

      return 0;
}

/* Generic servo: degrees → microseconds → pwm_set_pulse_dt
   deg in [0,180] maps to [min_us,max_us] (defaults 1000–2000 µs) */
int servo_write_deg(const pwm_dt_spec& servo,
                    float deg,
                    uint16_t min_us,
                    uint16_t max_us)
{
    if (!pwm_ready(servo)) return -ENODEV;
    if (deg < 0.f)   deg = 0.f;
    if (deg > 180.f) deg = 180.f;
    const float span = float(max_us - min_us);
    const uint32_t us = uint32_t(min_us + (deg / 180.f) * span);
    return pwm_set_pulse_dt(&servo, PWM_USEC(us));
}

int set_desired_thrust_newtons(double thrust_a_n, double thrust_b_n, double max_thrust_n){
    // 1000-2000 us PWM signal, double check range later
    double esc_1_us = util::mapFloat(thrust_a_n, 0, max_thrust_n, 1000, 2000);
    esc_write_us(ESC_1, esc_1_us);
    double esc_2_us = util::mapFloat(thrust_b_n, 0, max_thrust_n, 1000, 2000);

    esc_write_us(ESC_2, esc_2_us);
    return 0;
}

/* ESC helper: write a raw microsecond pulse (e.g., 1000–2000 µs) */
int esc_write_us(const pwm_dt_spec& esc, uint16_t us) {
    if (!pwm_ready(esc)) return -ENODEV;
    /* Clamp to something sane for hobby ESCs */
    if (us < 800)  us = 800;
    if (us > 2200) us = 2200;
    return pwm_set_pulse_dt(&esc, PWM_USEC(us));
}

int servo_neutral() {
    servo_write_deg(SERVO_X, 90);
    return servo_write_deg(SERVO_Y, 90);
}

int esc_idle() {
    esc_write_us(ESC_1, 1000);
    return esc_write_us(ESC_2, 1000);

}
```

## src/hornet_tvc.h
```c
#ifndef CLOVER_HORNET_TVC_H
#define CLOVER_HORNET_TVC_H

#include "util/math.h"
#include <zephyr/logging/log.h>
#include <zephyr/device.h>
#include <zephyr/devicetree.h>
#include <zephyr/kernel.h>
#include <zephyr/drivers/pwm.h>
/* Simple arming/idle step for the ESCs (e.g., hold ~1000 µs). */
int servos_init();

int esc_init();

/* Move both servos to achieve desired vector angle. */
int set_desired_thrust_deg(double thrust_deg_x, double thrust_deg_y);

/* Move both servos to target degrees */
int servo_write_deg(const pwm_dt_spec& servo, float deg,
                    uint16_t min_us = 1000, uint16_t max_us = 2000);

/* Set ESC's to achieve desired thrust in newtons. */
int set_desired_thrust_newtons(double thrust_a_n, double thrust_b_n, double max_thrust_n = 2.5);

/* Set raw throttle pulses for both ESCs in microseconds. */
int esc_write_us(const pwm_dt_spec& esc, uint16_t us);
/* Quick bring-up routine: arm ESCs and sweep servos. */

int servo_neutral();  /* servos ~90°, ESCs neutral if used */
int esc_idle();     /* ESCs ~1000 µs, servos unchanged   */

#endif //CLOVER_HORNET_TVC_H
```

## src/imu.cpp
```c
// imu.cpp - BNO08x IMU wrapper using Arduino-Core-Zephyr

#include "imu.h"

// Zephyr logging
#include <zephyr/logging/log.h>
LOG_MODULE_REGISTER(imu, CONFIG_LOG_DEFAULT_LEVEL);

#include <math.h>     // atan2f, asinf, acosf, cosf, sinf, sqrtf
#include <Arduino.h>
#include <SPI.h>
#include <Adafruit_BNO08x.h>
#include <sh2.h>      // sh2_SensorValue_t, sh2_saveDcdNow, SH2_ROTATION_VECTOR, SH2_OK


// ----- Euler ctor -----------------------------------------------------------

Euler::Euler(float yawDeg, float pitchDeg, float rollDeg)
    : yaw(yawDeg), pitch(pitchDeg), roll(rollDeg) {}

// ----- IMU public API -------------------------------------------------------
static constexpr uint8_t BNO_CS_PIN  = 10;  // Teensy CS
static constexpr uint8_t BNO_INT_PIN = 9;   // Your chosen INT pin
static constexpr uint8_t BNO_RST_PIN = 8;   // Your chosen RST pin

bool IMU::imu_init()
{
    LOG_INF("Initializing IMU");

    if (!_bno) {
        _bno = new Adafruit_BNO08x(BNO_RST_PIN);
        if (!_bno) {
            LOG_ERR("Failed to allocate Adafruit_BNO08x");
            return false;
        }
    }



    // Init SPI on the Arduino SPI bus (pins 10/11/12/13 on Teensy 4.1)
    SPI.begin();

    // Use the SPI begin instead of I2C
    if (!_bno->begin_SPI(BNO_CS_PIN, BNO_INT_PIN, &SPI)) {
        LOG_ERR("BNO08x begin_SPI failed");
        return false;
    }

    LOG_INF("BNO08x SPI init ok, enabling reports");

    // Enable the reports this application consumes
    _bno->enableReport(SH2_ROTATION_VECTOR, 10000);
    LOG_INF("IMU report enabled");

    LOG_INF("Finished IMU init");

    return true;
}

void IMU::imu_update()
{
    if (!_bno) {
        return;
    }

    if (_bno->wasReset())
    {
      Serial.println(F("[fly] IMU was reset."));
      _calibrationSaved        = false;
      _calibrationHighSinceMs  = 0;
      _lastCalSaveAttemptMs    = 0;
      _rvAccuracy              = 0;
      _rvAccuracyRad           = 0.0f;
    }

    sh2_SensorValue_t val;
    while (_bno->getSensorEvent(&val))
    {
      switch (val.sensorId)
      {
      case SH2_ROTATION_VECTOR:
        _quat.w = val.un.rotationVector.real;
        _quat.x = val.un.rotationVector.i;
        _quat.y = val.un.rotationVector.j;
        _quat.z = val.un.rotationVector.k;

        _quat       = normalize(_quat);
        _bodyQuat   = applyMountingCorrection(_quat);
        _bodyAxes   = quatToBodyAxes(_bodyQuat);
        _projectedAngles = computeProjectedAngles(_bodyAxes);
        _euler      = quatToEulerDeg(_bodyQuat);

        _rvAccuracyRad = val.un.rotationVector.accuracy;
        _rvAccuracy    = val.status & 0x03;
        _hasData       = true;
        break;

      default:
        break;
      }
    }

    if (_rvAccuracy >= 3)
    {
      if (_calibrationHighSinceMs == 0) {
        _calibrationHighSinceMs = millis();
      }
    }
    else
    {
      _calibrationHighSinceMs = 0;
      if (_rvAccuracy <= 1) {
        _calibrationSaved = false;
      }
    }

    const std::uint32_t now = millis();
    if (!_calibrationSaved && _calibrationHighSinceMs != 0)
    {
      constexpr std::uint32_t kMinStableMs = 3000;
      constexpr std::uint32_t kRetryMs     = 1000;
      bool stableLongEnough = (now - _calibrationHighSinceMs) >= kMinStableMs;
      bool retryElapsed     = (now - _lastCalSaveAttemptMs) >= kRetryMs;

      if (stableLongEnough && retryElapsed)
      {
        if (saveCalibration())
        {
          Serial.println(F("[fly] IMU calibration saved."));
          _calibrationHighSinceMs = 0;
        }
        else
        {
          Serial.println(F("[fly] IMU calibration save failed, will retry."));
          _lastCalSaveAttemptMs = now;
        }
      }
    }
}

bool IMU::hasData() const { return _hasData; }
QuaternionF IMU::quat() const { return _quat; }
QuaternionF IMU::bodyQuat() const { return _bodyQuat; }
Euler IMU::euler() const { return _euler; }

LinearAccel IMU::accelerometer() const { return _accelWorld; }
LinearAccel IMU::accelerometerWorld() const { return _accelWorld; }
LinearAccel IMU::accelerometerBody() const { return _accelBody; }
LinearAccel IMU::accelerometerSensor() const { return _rawAccel; }

std::uint8_t IMU::rotationAccuracy() const { return _rvAccuracy; }
float IMU::rotationAccuracyRad() const { return _rvAccuracyRad; }
bool IMU::isFullyCalibrated() const { return _rvAccuracy >= 3; }

BodyAxesF IMU::bodyAxes() const { return _bodyAxes; }
ProjectedAngles IMU::projectedAngles() const { return _projectedAngles; }

void IMU::setSensorToBodyEuler(float yawDeg, float pitchDeg, float rollDeg)
{
    _sensorToBody = normalize(quatFromEulerDeg(yawDeg, pitchDeg, rollDeg));
}

void IMU::setSensorToBodyQuat(const QuaternionF &q)
{
    _sensorToBody = normalize(q);
}

bool IMU::saveCalibration()
{
    const int rc = sh2_saveDcdNow();
    _lastCalSaveAttemptMs = millis();
    if (rc == SH2_OK)
    {
      _calibrationSaved = true;
      return true;
    }
    return false;
}

float IMU::yawDeg() const { return _euler.yaw; }
float IMU::pitchDeg() const { return _euler.pitch; }
float IMU::rollDeg() const { return _euler.roll; }

// ----- Static helpers -------------------------------------------------------

Euler IMU::quatToEulerDeg(const QuaternionF &q)
{
    const float ysqr = q.y * q.y;

    float t0 = +2.0f * (q.w * q.x + q.y * q.z);
    float t1 = +1.0f - 2.0f * (q.x * q.x + ysqr);
    float roll = atan2f(t0, t1);

    float t2 = +2.0f * (q.w * q.y - q.z * q.x);
    t2 = t2 > 1.0f ? 1.0f : (t2 < -1.0f ? -1.0f : t2);
    float pitch = asinf(t2);

    float t3 = +2.0f * (q.w * q.z + q.x * q.y);
    float t4 = +1.0f - 2.0f * (ysqr + q.z * q.z);
    float yaw = atan2f(t3, t4);

    return Euler{yaw * RAD2DEG, pitch * RAD2DEG, roll * RAD2DEG};
}

QuaternionF IMU::normalize(const QuaternionF &q)
{
    const float norm = sqrtf(q.w * q.w + q.x * q.x + q.y * q.y + q.z * q.z);
    if (norm <= 0.0f)
      return QuaternionF{};
    const float inv = 1.0f / norm;
    return QuaternionF{q.w * inv, q.x * inv, q.y * inv, q.z * inv};
}

QuaternionF IMU::conjugate(const QuaternionF &q)
{
    return QuaternionF{q.w, -q.x, -q.y, -q.z};
}

QuaternionF IMU::multiply(const QuaternionF &a, const QuaternionF &b)
{
    return QuaternionF{
        a.w * b.w - a.x * b.x - a.y * b.y - a.z * b.z,
        a.w * b.x + a.x * b.w + a.y * b.z - a.z * b.y,
        a.w * b.y - a.x * b.z + a.y * b.w + a.z * b.x,
        a.w * b.z + a.x * b.y - a.y * b.x + a.z * b.w};
}

QuaternionF IMU::quatFromEulerDeg(float yawDeg, float pitchDeg, float rollDeg)
{
    const float cy = cosf(0.5f * yawDeg * DEG2RAD);
    const float sy = sinf(0.5f * yawDeg * DEG2RAD);
    const float cp = cosf(0.5f * pitchDeg * DEG2RAD);
    const float sp = sinf(0.5f * pitchDeg * DEG2RAD);
    const float cr = cosf(0.5f * rollDeg * DEG2RAD);
    const float sr = sinf(0.5f * rollDeg * DEG2RAD);

    QuaternionF q{
        cy * cp * cr + sy * sp * sr,
        cy * cp * sr - sy * sp * cr,
        sy * cp * sr + cy * sp * cr,
        sy * cp * cr - cy * sp * sr};
    return normalize(q);
}

void IMU::rotateVector(const QuaternionF &q,
                       float x, float y, float z,
                       float &ox, float &oy, float &oz)
{
    const QuaternionF vec{0.0f, x, y, z};
    const QuaternionF qc  = conjugate(q);
    const QuaternionF tmp = multiply(q, vec);
    const QuaternionF res = multiply(tmp, qc);
    ox = res.x;
    oy = res.y;
    oz = res.z;
}

float IMU::clampf(float v, float lo, float hi)
{
    return v < lo ? lo : (v > hi ? hi : v);
}

BodyAxesF IMU::quatToBodyAxes(const QuaternionF &q)
{
    BodyAxesF axes{};
    rotateVector(q, 1.0f, 0.0f, 0.0f, axes.forwardX, axes.forwardY, axes.forwardZ);
    rotateVector(q, 0.0f, 1.0f, 0.0f, axes.rightX,  axes.rightY,  axes.rightZ);
    rotateVector(q, 0.0f, 0.0f, 1.0f, axes.upX,     axes.upY,     axes.upZ);
    return axes;
}

ProjectedAngles IMU::computeProjectedAngles(const BodyAxesF &axes)
{
    ProjectedAngles proj{};
    proj.tiltAboutX = atan2f(-axes.upY, axes.upZ) * RAD2DEG;
    proj.tiltAboutY = atan2f(axes.upX,  axes.upZ) * RAD2DEG;
    proj.totalTilt  = acosf(clampf(axes.upZ, -1.0f, 1.0f)) * RAD2DEG;

    const float heading = atan2f(axes.forwardY, axes.forwardX);
    proj.heading = heading * RAD2DEG;
    return proj;
}

QuaternionF IMU::applyMountingCorrection(const QuaternionF &sensorQuat) const
{
    return normalize(multiply(sensorQuat, conjugate(_sensorToBody)));
}
```

## src/imu.h
```c
#ifndef CLOVER_IMU_H
#define CLOVER_IMU_H

#include <cstdint>

// Forward declaration to avoid pulling in heavy Adafruit headers here.
class Adafruit_BNO08x;

/**
 * Simple IMU interface around a BNO08x device.
 * Provides orientation (quaternion, Euler), body axes, and accel data.
 */

struct LinearAccel
{
  float x{0.0f};
  float y{0.0f};
  float z{0.0f}; // m/s^2
};

struct Euler
{
  float yaw{0.0f};   // degrees
  float pitch{0.0f}; // degrees
  float roll{0.0f};  // degrees

  Euler() = default;
  Euler(float yawDeg, float pitchDeg, float rollDeg);
};

struct QuaternionF
{
  float w{1.0f};
  float x{0.0f};
  float y{0.0f};
  float z{0.0f}; // unit quaternion
};

struct BodyAxesF
{
  float forwardX{1.0f}, forwardY{0.0f}, forwardZ{0.0f};
  float rightX{0.0f},  rightY{1.0f},  rightZ{0.0f};
  float upX{0.0f},     upY{0.0f},     upZ{1.0f};
};

struct ProjectedAngles
{
  float tiltAboutX{0.0f}; // deg, rotation about body X (roll)
  float tiltAboutY{0.0f}; // deg, rotation about body Y (pitch)
  float totalTilt{0.0f};  // deg from vertical
  float heading{0.0f};    // deg, yaw derived from forward vector projection
};

class IMU
{
public:
  // Initialize IMU hardware and enable the rotation-vector report.
  bool imu_init();

  // Polls the IMU and updates orientation/accel state.
  void imu_update();

  // Accessors for current state.
  bool hasData() const;
  QuaternionF quat() const;
  QuaternionF bodyQuat() const;
  Euler euler() const;

  LinearAccel accelerometer() const;
  LinearAccel accelerometerWorld() const;
  LinearAccel accelerometerBody() const;
  LinearAccel accelerometerSensor() const;

  uint8_t rotationAccuracy() const;
  float rotationAccuracyRad() const;
  bool isFullyCalibrated() const;

  BodyAxesF bodyAxes() const;
  ProjectedAngles projectedAngles() const;

  // Mounting correction configuration.
  void setSensorToBodyEuler(float yawDeg, float pitchDeg, float rollDeg);
  void setSensorToBodyQuat(const QuaternionF &q);

  // Persist calibration to NVM (if supported by the device).
  bool saveCalibration();

  // Convenience getters for Euler components.
  float yawDeg() const;
  float pitchDeg() const;
  float rollDeg() const;

private:
  static constexpr float RAD2DEG = 57.2957795f;
  static constexpr float DEG2RAD = 0.0174532925f;

  // Quaternion / math helpers (implemented in imu.cpp).
  static Euler        quatToEulerDeg(const QuaternionF &q);
  static QuaternionF  normalize(const QuaternionF &q);
  static QuaternionF  conjugate(const QuaternionF &q);
  static QuaternionF  multiply(const QuaternionF &a, const QuaternionF &b);
  static QuaternionF  quatFromEulerDeg(float yawDeg, float pitchDeg, float rollDeg);
  static void         rotateVector(const QuaternionF &q,
                                   float x, float y, float z,
                                   float &ox, float &oy, float &oz);
  static float        clampf(float v, float lo, float hi);
  static BodyAxesF    quatToBodyAxes(const QuaternionF &q);
  static ProjectedAngles computeProjectedAngles(const BodyAxesF &axes);

  QuaternionF applyMountingCorrection(const QuaternionF &sensorQuat) const;

  // State
  Adafruit_BNO08x *_bno{nullptr};   // or value-type if you prefer; match imu.cpp

  QuaternionF   _quat{};
  QuaternionF   _bodyQuat{};
  Euler         _euler{};
  LinearAccel   _rawAccel{};
  LinearAccel   _accelBody{};
  LinearAccel   _accelWorld{};
  bool          _hasData{false};
  uint8_t       _rvAccuracy{0};
  float         _rvAccuracyRad{0.0f};
  bool          _calibrationSaved{false};
  std::uint32_t _calibrationHighSinceMs{0};
  std::uint32_t _lastCalSaveAttemptMs{0};
  QuaternionF   _sensorToBody{};
  BodyAxesF     _bodyAxes{};
  ProjectedAngles _projectedAngles{};
};

#endif // CLOVER_IMU_H
```

## src/pts.cpp
```c
#include "pts.h"

#include <zephyr/sys/util.h>
#include <zephyr/drivers/adc.h>
#include <zephyr/logging/log.h>
#include <zephyr/kernel.h>
#include <array>

#define USER_NODE DT_PATH(zephyr_user)

// Validate devicetree
#if !DT_NODE_HAS_PROP(USER_NODE, pt_names)
#error "pts: Missing `pt-names` property from `zephyr-user` node."
#endif

#if !DT_NODE_HAS_PROP(USER_NODE, io_channels)
#error "pts: Missing `io-channels` property from `zephyr-user` node."
#endif

#if DT_PROP_LEN(USER_NODE, pt_names) != DT_PROP_LEN(USER_NODE, io_channels)
#error "pts: `pt-names` and `io-channels` must have the same length."
#endif

#define CONFIG_PT_SAMPLES 1

// Trailing comma needed as we are using preprocessor to instantiate each element of an array.
#define CLOVER_PTS_DT_SPEC_AND_COMMA(node_id, prop, idx) ADC_DT_SPEC_GET_BY_IDX(node_id, idx),
static constexpr struct adc_dt_spec adc_channels[NUM_PTS] = {
    DT_FOREACH_PROP_ELEM(USER_NODE, io_channels, CLOVER_PTS_DT_SPEC_AND_COMMA)
};

static adc_sequence_options sequence_options = {
    .interval_us = 0,
    .extra_samplings = CONFIG_PT_SAMPLES - 1,
};
static adc_sequence sequence;
uint16_t raw_readings[CONFIG_PT_SAMPLES][NUM_PTS];

static pt_readings last_reading;
static int64_t last_read_uptime;

LOG_MODULE_REGISTER(pts, CONFIG_LOG_DEFAULT_LEVEL);

consteval std::array<float, NUM_PTS> pts_adc_ranges()
{
    std::array<float, NUM_PTS> ranges;
    for (int i = 0; i < NUM_PTS; ++i) {
        ranges[i] = static_cast<float>(1 << static_cast<uint32_t>(adc_channels[i].resolution));
    }
    return ranges;
}

pt_config pt_configs[NUM_PTS] = {
    {
        .scale = 1000.0f / pts_adc_ranges()[0],
        .bias = -14.5f,
        .range = 1000.0f
    },
    {
        .scale = 2000.0f / pts_adc_ranges()[1],
        .bias = -38.0f,
        .range = 2000.0f
    },
    {
        .scale = 2000.0f / pts_adc_ranges()[2],
        .bias = -32f,
        .range = 2000.0f
    },
    {
        .scale = 2000.0f / pts_adc_ranges()[3],
        .bias = -33.0f-13.0f,
        .range = 2000.0f
    },
    {
        .scale = 2000.0f / pts_adc_ranges()[4],
        .bias = -31.0f,
        .range = 2000.0f
    },
    {
        .scale = 1000.0f / pts_adc_ranges()[5],
        .bias = -18.7f+1.5f-0.8f,
        .range = 1000.0f
    },
    {
        .scale = 3000.0f / pts_adc_ranges()[6],
        .bias = -40.0f,
        .range = 3000.0f
    },
    {
        .scale = 1000.0f / pts_adc_ranges()[7],
        .bias = -13.0f-0.25f,
        .range = 1000.0f
    },
};

/// Initialize PT sensors by initializing the ADC they're all connected to.
int pts_init()
{
    // Initializes resolution and oversampling from device tree. Let's assume all channels share those properties. Also
    // initializes `channels` with just one channel, so we overwrite that later to sample all channels at once.
    LOG_INF("Initializing ADC sequence");
    adc_sequence_init_dt(&adc_channels[0], &sequence);
    sequence.buffer = raw_readings;
    sequence.buffer_size = sizeof raw_readings;
    sequence.options = &sequence_options;

    // Configure ADC channels.
    for (int i = 0; i < NUM_PTS; i++) {
        LOG_INF("pt %d: Checking readiness", i);
        if (!adc_is_ready_dt(&adc_channels[i])) {
            LOG_ERR("pt %d: ADC controller device %s not ready", i, adc_channels[i].dev->name);
            return 1;
        }

        LOG_INF("pt %d: Initializing channel", i);
        int err = adc_channel_setup_dt(&adc_channels[i]);
        if (err) {
            LOG_ERR("pt %d: Failed to set up channel: err %d", i, err);
            return 1;
        }

        // Request reading for this channel in sequence.
        sequence.channels |= BIT(adc_channels[i].channel_id);
    }

    return 0;
}

/// Update PT sample readings.
pt_readings pts_sample()
{
    int err = adc_read(adc_channels[0].dev, &sequence);
    if (err) {
        LOG_ERR("Failed to read from ADC: err %d", err);
        return pt_readings{};
    }

    // Averaging readings
    float readings_by_idx[NUM_PTS] = {0};
    for (int i = 0; i < NUM_PTS; ++i) {
        for (int j = 0; j < CONFIG_PT_SAMPLES; ++j) {
            readings_by_idx[i] += static_cast<float>(raw_readings[j][i]);
        }
        readings_by_idx[i] = readings_by_idx[i] / CONFIG_PT_SAMPLES * pt_configs[i].scale + pt_configs[i].bias;
    }

    // Assign each PT name as fields to initialize pt_readings
#define CLOVER_PTS_DT_TO_READINGS_ASSIGNMENT(node_id, prop, idx) .DT_STRING_TOKEN_BY_IDX(node_id, prop, idx) = readings_by_idx[idx],
    auto readings = pt_readings{
        DT_FOREACH_PROP_ELEM(USER_NODE, pt_names, CLOVER_PTS_DT_TO_READINGS_ASSIGNMENT)
    };
    last_reading = readings;
    last_read_uptime = k_uptime_get();
    return readings;
}

/// Gets the last sample if it's sufficiently recent, or resample manually.
pt_readings pts_get_last_reading()
{
    // If last PT reading was less than 100 ms ago
    if (k_uptime_get() - last_read_uptime < 100) {
        return last_reading;
    }
    return pts_sample();
}

int pts_set_bias(int index, float bias)
{
    if (index < 0 || index >= NUM_PTS) {
        LOG_ERR("Invalid PT index: %d", index);
        return 1;
    }

    pt_configs[index].bias = bias;

    return 0;
}

int pts_set_range(int index, float range)
{
    if (index < 0 || index >= NUM_PTS) {
        LOG_ERR("Invalid PT index: %d", index);
        return 1;
    }

    pt_configs[index].range = range;
    pt_configs[index].scale = range / pts_adc_ranges()[index];

    return 0;
}
```

## src/pts.h
```c
#ifndef CLOVER_PTS_H
#define CLOVER_PTS_H

#include <zephyr/devicetree.h>

/*
 * The following macro magic is used to generate a struct to hold the result of one PT reading. If the device tree has:
 *     ...
 *     names = "pt201", "pt202", "pt203", "pt204";
 *     io-channels = <&adc1 7>, <&adc1 8>, <&adc1 12>, <&adc1 11>;
 *     ...
 *
 * We will generate the following:
 * struct pt_readings {
 *     float pt201;
 *     float pt202;
 *     ...
 * }
 */

#define USER_NODE DT_PATH(zephyr_user)

#define CLOVER_PTS_DT_TO_READINGS_FIELD(node_id, prop, idx) float DT_STRING_TOKEN_BY_IDX(node_id, prop, idx);
struct pt_readings {
    DT_FOREACH_PROP_ELEM(USER_NODE, pt_names, CLOVER_PTS_DT_TO_READINGS_FIELD)
};

struct pt_config {
    float scale; // psig per analog reading unit. For teensy, resolution = 12, so for a 1k PT this would be (1000.0 / 4096.0)
    float bias;
    float range;
};

constexpr int NUM_PTS = DT_PROP_LEN(USER_NODE, io_channels);
extern pt_config pt_configs[NUM_PTS];

int pts_init();

pt_readings pts_sample();
pt_readings pts_sample_mavg(int window);


void pts_log_readings(const pt_readings &readings);
void pts_log_readings_mavg();


int pts_set_bias(int index, float bias);

int pts_set_range(int index, float range);

#endif //CLOVER_PTS_H
```

## src/sequencer.h
```c
#ifndef CLOVER_SEQUENCER_H
#define CLOVER_SEQUENCER_H

#include <vector>

int sequencer_prepare(int gap, std::vector<float> fuel_bps, std::vector<float> lox_bps, bool mot_only);

int sequencer_prepare_sine(int total_time, float offset, float amplitude, float period, float phase);

int sequencer_prepare_combo(
    int gap,
    const std::vector<float> &fuel_bps,
    const std::vector<float> &lox_bps,
    const std::vector<float> &seq_sine_offsets_fuel,
    const std::vector<float> &seq_sine_amps_fuel,
    const std::vector<float> &seq_sine_periods_fuel,
    const std::vector<float> &seq_sine_phases_fuel,
    const std::vector<float> &seq_sine_offsets_lox,
    const std::vector<float> &seq_sine_amps_lox,
    const std::vector<float> &seq_sine_periods_lox,
    const std::vector<float> &seq_sine_phases_lox,
    bool mot_only);
int sequencer_start_trace();

void sequencer_set_data_recipient(int sock);

int sequencer_get_data_recipient();

void sequencer_halt();

#endif //CLOVER_SEQUENCER_H
```
