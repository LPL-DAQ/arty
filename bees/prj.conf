## CMakeLists.txt
```
cmake_minimum_required(VERSION 3.13.1)

find_package(Zephyr REQUIRED HINTS $ENV{ZEPHYR_BASE})
project(app)

add_subdirectory(${CMAKE_CURRENT_SOURCE_DIR}/../lib/extmem extmem_build)

target_sources(app PRIVATE
    src/main.cpp
)
```

## prj.conf
```kconfig
CONFIG_CPP=y
CONFIG_STD_CPP2B=y  # Applies std=C++23
CONFIG_LOG_MODE_IMMEDIATE=y
CONFIG_REQUIRES_FULL_LIBC=y
CONFIG_GLIBCXX_LIBCPP=y
CONFIG_NEWLIB_LIBC=y
CONFIG_CBPRINTF_LIBC_SUBSTS=y

CONFIG_DEBUG_COREDUMP=y
CONFIG_LOG=y
CONFIG_SERIAL=y

# uart console is currently chopped.
CONFIG_CONSOLE=n

# Required for debugging
CONFIG_STM32_ENABLE_DEBUG_SLEEP_STOP=y
CONFIG_NO_OPTIMIZATIONS=y

# Set the following if you're connected directly via ethernet.
# CONFIG_NET_CONFIG_MY_IPV4_ADDR="169.254.99.99"
# CONFIG_NET_CONFIG_MY_IPV4_NETMASK="255.255.0.0"

# Set the following if you're connected via the DAQ box router.
# CONFIG_NET_CONFIG_MY_IPV4_ADDR="192.168.0.150"
# CONFIG_NET_CONFIG_MY_IPV4_NETMASK="255.255.255.0"
# CONFIG_NET_CONFIG_MY_IPV4_GW="192.168.0.1"

# # Add nanopb, used to serialize and deserialize requests and responses for the command server.
# CONFIG_NANOPB=y

# # Enable preemptive multithreading
# CONFIG_TIMESLICING=y
# CONFIG_TIMESLICE_SIZE=10
# CONFIG_TIMESLICE_PRIORITY=5

# # Enable networking
# CONFIG_NETWORKING=y
# CONFIG_NET_UDP=y
# CONFIG_NET_TCP=y
# CONFIG_NET_IPV4=y
# CONFIG_NET_LOG=y
# CONFIG_NET_CONFIG_SETTINGS=y
# CONFIG_NET_CONFIG_NEED_IPV4=y
# CONFIG_NET_L2_ETHERNET=y
# CONFIG_NET_CONFIG_INIT_TIMEOUT=0
# CONFIG_NET_CONTEXT_RCVTIMEO=y
# CONFIG_NET_SOCKETS=y
# CONFIG_NET_TX_STACK_SIZE=4096
# CONFIG_NET_RX_STACK_SIZE=4096
# CONFIG_NET_PKT_RX_COUNT=64
# CONFIG_NET_PKT_TX_COUNT=64
# CONFIG_NET_BUF_RX_COUNT=64
# CONFIG_NET_BUF_TX_COUNT=64
# CONFIG_NET_MAX_CONN=64
# CONFIG_NET_MAX_CONTEXTS=64
# CONFIG_NET_CONNECTION_MANAGER=y
# CONFIG_NET_TCP_TIME_WAIT_DELAY=0
# CONFIG_POSIX_NETWORKING=y  # Links POSIX networking functions like inet_addr

# # Enable ADC and logging
# CONFIG_ADC=y
# CONFIG_ADC_LOG_LEVEL_WRN=y

# CONFIG_INIT_STACKS=y

# CONFIG_SYSTEM_WORKQUEUE_STACK_SIZE=4096

# # Uncomment to configure a periodic console message of thread CPU/stack usage.
# # CONFIG_THREAD_ANALYZER=y
# # CONFIG_THREAD_ANALYZER_AUTO=y
# # CONFIG_THREAD_ANALYZER_AUTO_INTERVAL=5
# # CONFIG_THREAD_NAME=y

CONFIG_MEMC=y
CONFIG_MEMC_MCUX_FLEXSPI=y
CONFIG_MEMC_MCUX_FLEXSPI_APS6404L=y
```

## src/main.cpp
```c
#include <zephyr/kernel.h>
#include <zephyr/sys/printk.h>
#include <cstdint>

int main(void)
{
    printk("PSRAM test start\n");

    volatile uint32_t* psram = reinterpret_cast<volatile uint32_t*>(0x70000000);

    // write
    psram[0] = 123;
    psram[1] = 456;

    // read
    uint32_t a = psram[0];
    uint32_t b = psram[1];

    printk("PSRAM readback: %u %u\n", a, b);

    while (true) {
        k_sleep(K_SECONDS(1));
    }
}
```
