## lora-responder/build/Kconfig/boards/Kconfig.teensy41
```kconfig
# Load board Kconfig descriptions.
osource "/home/lpl/zephyr/boards/pjrc/teensy4/Kconfig.teensy41"
```

## lora-responder/build/Kconfig/soc/Kconfig.defconfig
```kconfig
# Load Zephyr SoC defconfig descriptions.
osource "/home/lpl/zephyr/soc/xlnx/zynqmp/Kconfig.defconfig"
osource "/home/lpl/zephyr/soc/xlnx/zynq7000/Kconfig.defconfig"
osource "/home/lpl/zephyr/soc/xlnx/versalnet/Kconfig.defconfig"
osource "/home/lpl/zephyr/soc/xlnx/versal2/Kconfig.defconfig"
osource "/home/lpl/zephyr/soc/xen/Kconfig.defconfig"
osource "/home/lpl/zephyr/soc/wch/ch32v/Kconfig.defconfig"
osource "/home/lpl/zephyr/soc/ti/simplelink/Kconfig.defconfig"
osource "/home/lpl/zephyr/soc/ti/mspm0/Kconfig.defconfig"
osource "/home/lpl/zephyr/soc/ti/lm3s6965/Kconfig.defconfig"
osource "/home/lpl/zephyr/soc/ti/k3/Kconfig.defconfig"
osource "/home/lpl/zephyr/soc/telink/tlsr/Kconfig.defconfig"
osource "/home/lpl/zephyr/soc/starfive/jh71xx/Kconfig.defconfig"
osource "/home/lpl/zephyr/soc/st/stm32/Kconfig.defconfig"
osource "/home/lpl/zephyr/soc/snps/qemu_arc/Kconfig.defconfig"
osource "/home/lpl/zephyr/soc/snps/nsim/arc_v/Kconfig.defconfig"
osource "/home/lpl/zephyr/soc/snps/nsim/arc_classic/Kconfig.defconfig"
osource "/home/lpl/zephyr/soc/snps/hsdk4xd/Kconfig.defconfig"
osource "/home/lpl/zephyr/soc/snps/hsdk/Kconfig.defconfig"
osource "/home/lpl/zephyr/soc/snps/emsk/Kconfig.defconfig"
osource "/home/lpl/zephyr/soc/snps/emsdp/Kconfig.defconfig"
osource "/home/lpl/zephyr/soc/snps/arc_iot/Kconfig.defconfig"
osource "/home/lpl/zephyr/soc/silabs/Kconfig.defconfig"
osource "/home/lpl/zephyr/soc/sifive/sifive_freedom/Kconfig.defconfig"
osource "/home/lpl/zephyr/soc/sensry/Kconfig.defconfig"
osource "/home/lpl/zephyr/soc/rockchip/Kconfig.defconfig"
osource "/home/lpl/zephyr/soc/renode/riscv_virtual/Kconfig.defconfig"
osource "/home/lpl/zephyr/soc/renode/cortex_r8_virtual/Kconfig.defconfig"
osource "/home/lpl/zephyr/soc/renesas/smartbond/Kconfig.defconfig"
osource "/home/lpl/zephyr/soc/renesas/rz/Kconfig.defconfig"
osource "/home/lpl/zephyr/soc/renesas/rx/Kconfig.defconfig"
osource "/home/lpl/zephyr/soc/renesas/rcar/Kconfig.defconfig"
osource "/home/lpl/zephyr/soc/renesas/ra/Kconfig.defconfig"
osource "/home/lpl/zephyr/soc/realtek/ec/Kconfig.defconfig"
osource "/home/lpl/zephyr/soc/raspberrypi/rpi_pico/Kconfig.defconfig"
osource "/home/lpl/zephyr/soc/quicklogic/eos_s3/Kconfig.defconfig"
osource "/home/lpl/zephyr/soc/qemu/virt_riscv/Kconfig.defconfig"
osource "/home/lpl/zephyr/soc/qemu/malta/Kconfig.defconfig"
osource "/home/lpl/zephyr/soc/openisa/rv32m1/Kconfig.defconfig"
osource "/home/lpl/zephyr/soc/openhwgroup/cva6/Kconfig.defconfig"
osource "/home/lpl/zephyr/soc/oct/osd32mp15x/Kconfig.defconfig"
osource "/home/lpl/zephyr/soc/nxp/s32/Kconfig.defconfig"
osource "/home/lpl/zephyr/soc/nxp/rw/Kconfig.defconfig"
osource "/home/lpl/zephyr/soc/nxp/mcx/Kconfig.defconfig"
osource "/home/lpl/zephyr/soc/nxp/lpc/Kconfig.defconfig"
osource "/home/lpl/zephyr/soc/nxp/layerscape/Kconfig.defconfig"
osource "/home/lpl/zephyr/soc/nxp/kinetis/Kconfig.defconfig"
osource "/home/lpl/zephyr/soc/nxp/imxrt/Kconfig.defconfig"
osource "/home/lpl/zephyr/soc/nxp/imx/Kconfig.defconfig"
osource "/home/lpl/zephyr/soc/nuvoton/numicro/Kconfig.defconfig"
osource "/home/lpl/zephyr/soc/nuvoton/numaker/Kconfig.defconfig"
osource "/home/lpl/zephyr/soc/nuvoton/npcx/Kconfig.defconfig"
osource "/home/lpl/zephyr/soc/nuvoton/npcm/Kconfig.defconfig"
osource "/home/lpl/zephyr/soc/nordic/Kconfig.defconfig"
osource "/home/lpl/zephyr/soc/neorv32/Kconfig.defconfig"
osource "/home/lpl/zephyr/soc/native/inf_clock/Kconfig.defconfig"
osource "/home/lpl/zephyr/soc/microchip/sam/Kconfig.defconfig"
osource "/home/lpl/zephyr/soc/microchip/miv/Kconfig.defconfig"
osource "/home/lpl/zephyr/soc/microchip/mec/Kconfig.defconfig"
osource "/home/lpl/zephyr/soc/mediatek/mt8xxx/Kconfig.defconfig"
osource "/home/lpl/zephyr/soc/lowrisc/opentitan/Kconfig.defconfig"
osource "/home/lpl/zephyr/soc/litex/litex_vexriscv/Kconfig.defconfig"
osource "/home/lpl/zephyr/soc/ite/ec/Kconfig.defconfig"
osource "/home/lpl/zephyr/soc/intel/raptor_lake/Kconfig.defconfig"
osource "/home/lpl/zephyr/soc/intel/lakemont/Kconfig.defconfig"
osource "/home/lpl/zephyr/soc/intel/intel_socfpga_std/Kconfig.defconfig"
osource "/home/lpl/zephyr/soc/intel/intel_socfpga/Kconfig.defconfig"
osource "/home/lpl/zephyr/soc/intel/intel_niosv/Kconfig.defconfig"
osource "/home/lpl/zephyr/soc/intel/intel_ish/Kconfig.defconfig"
osource "/home/lpl/zephyr/soc/intel/intel_adsp/Kconfig.defconfig"
osource "/home/lpl/zephyr/soc/intel/elkhart_lake/Kconfig.defconfig"
osource "/home/lpl/zephyr/soc/intel/atom/Kconfig.defconfig"
osource "/home/lpl/zephyr/soc/intel/apollo_lake/Kconfig.defconfig"
osource "/home/lpl/zephyr/soc/intel/alder_lake/Kconfig.defconfig"
osource "/home/lpl/zephyr/soc/infineon/cat3/Kconfig.defconfig"
osource "/home/lpl/zephyr/soc/infineon/cat1c/Kconfig.defconfig"
osource "/home/lpl/zephyr/soc/infineon/cat1b/Kconfig.defconfig"
osource "/home/lpl/zephyr/soc/infineon/cat1a/Kconfig.defconfig"
osource "/home/lpl/zephyr/soc/gd/gd32/Kconfig.defconfig"
osource "/home/lpl/zephyr/soc/gaisler/leon3/Kconfig.defconfig"
osource "/home/lpl/zephyr/soc/gaisler/gr716a/Kconfig.defconfig"
osource "/home/lpl/zephyr/soc/espressif/Kconfig.defconfig"
osource "/home/lpl/zephyr/soc/ene/kb1200/Kconfig.defconfig"
osource "/home/lpl/zephyr/soc/ene/kb106x/Kconfig.defconfig"
osource "/home/lpl/zephyr/soc/efinix/sapphire/Kconfig.defconfig"
osource "/home/lpl/zephyr/soc/cdns/xtensa_sample_controller/Kconfig.defconfig"
osource "/home/lpl/zephyr/soc/cdns/sample_controller32/Kconfig.defconfig"
osource "/home/lpl/zephyr/soc/cdns/dc233c/Kconfig.defconfig"
osource "/home/lpl/zephyr/soc/brcm/bcmvk/Kconfig.defconfig"
osource "/home/lpl/zephyr/soc/brcm/bcm2712/Kconfig.defconfig"
osource "/home/lpl/zephyr/soc/brcm/bcm2711/Kconfig.defconfig"
osource "/home/lpl/zephyr/soc/bflb/Kconfig.defconfig"
osource "/home/lpl/zephyr/soc/atmel/sam0/Kconfig.defconfig"
osource "/home/lpl/zephyr/soc/atmel/sam/Kconfig.defconfig"
osource "/home/lpl/zephyr/soc/aspeed/Kconfig.defconfig"
osource "/home/lpl/zephyr/soc/arm/Kconfig.defconfig"
osource "/home/lpl/zephyr/soc/arm/beetle/Kconfig.defconfig"
osource "/home/lpl/zephyr/soc/antmicro/myra/Kconfig.defconfig"
osource "/home/lpl/zephyr/soc/andestech/Kconfig.defconfig"
osource "/home/lpl/zephyr/soc/amd/acp_6_0/Kconfig.defconfig"
osource "/home/lpl/zephyr/soc/ambiq/Kconfig.defconfig"
osource "/home/lpl/zephyr/soc/aesc/Kconfig.defconfig"
osource "/home/lpl/zephyr/soc/adi/max32/Kconfig.defconfig"
```

## tests/mcp23017_test/build/Kconfig/Kconfig.sysbuild.modules
```kconfig
config ZEPHYR_ARTY_MODULE
   bool
   default y
config ZEPHYR_ARDUINO_API_MODULE
   bool
   default y
config ZEPHYR_NANOPB_MODULE
   bool
   default y
config ZEPHYR_CMSIS_6_MODULE
   bool
   default y
config ZEPHYR_HAL_NXP_MODULE
   bool
   default y
config ZEPHYR_HAL_STM32_MODULE
   bool
   default y
```

## tests/mcp23017_test/build/Kconfig/arch/Kconfig
```kconfig
# Load Zephyr Arch Kconfig descriptions.
osource "/home/lpl/zephyr/arch/rx/Kconfig"
osource "/home/lpl/zephyr/arch/x86/Kconfig"
osource "/home/lpl/zephyr/arch/xtensa/Kconfig"
osource "/home/lpl/zephyr/arch/sparc/Kconfig"
osource "/home/lpl/zephyr/arch/riscv/Kconfig"
osource "/home/lpl/zephyr/arch/posix/Kconfig"
osource "/home/lpl/zephyr/arch/mips/Kconfig"
osource "/home/lpl/zephyr/arch/arm64/Kconfig"
osource "/home/lpl/zephyr/arch/arm/Kconfig"
osource "/home/lpl/zephyr/arch/arc/Kconfig"
```

## tests/mcp23017_test/build/Kconfig/boards/Kconfig
```kconfig
# Load Zephyr board Kconfig descriptions.
osource "/workspaces/arty/boards/lpl/teensy_hive/Kconfig"
```

## tests/mcp23017_test/build/Kconfig/boards/Kconfig.defconfig
```kconfig
# Load Zephyr board defconfig descriptions.
osource "/workspaces/arty/boards/lpl/teensy_hive/Kconfig.defconfig"
```

## tests/mcp23017_test/build/Kconfig/boards/Kconfig.ranger_1
```kconfig
# Load board Kconfig descriptions.
osource "/workspaces/arty/boards/lpl/teensy_hive/Kconfig.ranger_1"
```

## tests/mcp23017_test/build/Kconfig/boards/Kconfig.sysbuild
```kconfig
# Load Sysbuild board Kconfig descriptions.
osource "/workspaces/arty/boards/lpl/teensy_hive/Kconfig.sysbuild"
```

## tests/mcp23017_test/build/Kconfig/soc/Kconfig
```kconfig
# Load Zephyr SoC Kconfig descriptions.
osource "/home/lpl/zephyr/soc/xlnx/zynqmp/Kconfig"
osource "/home/lpl/zephyr/soc/xlnx/zynq7000/Kconfig"
osource "/home/lpl/zephyr/soc/xlnx/versalnet/Kconfig"
osource "/home/lpl/zephyr/soc/xlnx/versal2/Kconfig"
osource "/home/lpl/zephyr/soc/xen/Kconfig"
osource "/home/lpl/zephyr/soc/wch/ch32v/Kconfig"
osource "/home/lpl/zephyr/soc/ti/simplelink/Kconfig"
osource "/home/lpl/zephyr/soc/ti/mspm0/Kconfig"
osource "/home/lpl/zephyr/soc/ti/lm3s6965/Kconfig"
osource "/home/lpl/zephyr/soc/ti/k3/Kconfig"
osource "/home/lpl/zephyr/soc/telink/tlsr/Kconfig"
osource "/home/lpl/zephyr/soc/starfive/jh71xx/Kconfig"
osource "/home/lpl/zephyr/soc/st/stm32/Kconfig"
osource "/home/lpl/zephyr/soc/snps/qemu_arc/Kconfig"
osource "/home/lpl/zephyr/soc/snps/nsim/arc_v/Kconfig"
osource "/home/lpl/zephyr/soc/snps/nsim/arc_classic/Kconfig"
osource "/home/lpl/zephyr/soc/snps/hsdk4xd/Kconfig"
osource "/home/lpl/zephyr/soc/snps/hsdk/Kconfig"
osource "/home/lpl/zephyr/soc/snps/emsk/Kconfig"
osource "/home/lpl/zephyr/soc/snps/emsdp/Kconfig"
osource "/home/lpl/zephyr/soc/snps/arc_iot/Kconfig"
osource "/home/lpl/zephyr/soc/silabs/Kconfig"
osource "/home/lpl/zephyr/soc/sifive/sifive_freedom/Kconfig"
osource "/home/lpl/zephyr/soc/sensry/Kconfig"
osource "/home/lpl/zephyr/soc/rockchip/Kconfig"
osource "/home/lpl/zephyr/soc/renode/riscv_virtual/Kconfig"
osource "/home/lpl/zephyr/soc/renode/cortex_r8_virtual/Kconfig"
osource "/home/lpl/zephyr/soc/renesas/smartbond/Kconfig"
osource "/home/lpl/zephyr/soc/renesas/rz/Kconfig"
osource "/home/lpl/zephyr/soc/renesas/rx/Kconfig"
osource "/home/lpl/zephyr/soc/renesas/rcar/Kconfig"
osource "/home/lpl/zephyr/soc/renesas/ra/Kconfig"
osource "/home/lpl/zephyr/soc/realtek/ec/Kconfig"
osource "/home/lpl/zephyr/soc/raspberrypi/rpi_pico/Kconfig"
osource "/home/lpl/zephyr/soc/quicklogic/eos_s3/Kconfig"
osource "/home/lpl/zephyr/soc/qemu/virt_riscv/Kconfig"
osource "/home/lpl/zephyr/soc/qemu/malta/Kconfig"
osource "/home/lpl/zephyr/soc/openisa/rv32m1/Kconfig"
osource "/home/lpl/zephyr/soc/openhwgroup/cva6/Kconfig"
osource "/home/lpl/zephyr/soc/oct/osd32mp15x/Kconfig"
osource "/home/lpl/zephyr/soc/nxp/s32/Kconfig"
osource "/home/lpl/zephyr/soc/nxp/rw/Kconfig"
osource "/home/lpl/zephyr/soc/nxp/mcx/Kconfig"
osource "/home/lpl/zephyr/soc/nxp/lpc/Kconfig"
osource "/home/lpl/zephyr/soc/nxp/layerscape/Kconfig"
osource "/home/lpl/zephyr/soc/nxp/kinetis/Kconfig"
osource "/home/lpl/zephyr/soc/nxp/imxrt/Kconfig"
osource "/home/lpl/zephyr/soc/nxp/imx/Kconfig"
osource "/home/lpl/zephyr/soc/nuvoton/numicro/Kconfig"
osource "/home/lpl/zephyr/soc/nuvoton/numaker/Kconfig"
osource "/home/lpl/zephyr/soc/nuvoton/npcx/Kconfig"
osource "/home/lpl/zephyr/soc/nuvoton/npcm/Kconfig"
osource "/home/lpl/zephyr/soc/nordic/Kconfig"
osource "/home/lpl/zephyr/soc/neorv32/Kconfig"
osource "/home/lpl/zephyr/soc/native/inf_clock/Kconfig"
osource "/home/lpl/zephyr/soc/microchip/sam/Kconfig"
osource "/home/lpl/zephyr/soc/microchip/miv/Kconfig"
osource "/home/lpl/zephyr/soc/microchip/mec/Kconfig"
osource "/home/lpl/zephyr/soc/mediatek/mt8xxx/Kconfig"
osource "/home/lpl/zephyr/soc/lowrisc/opentitan/Kconfig"
osource "/home/lpl/zephyr/soc/litex/litex_vexriscv/Kconfig"
osource "/home/lpl/zephyr/soc/ite/ec/Kconfig"
osource "/home/lpl/zephyr/soc/intel/raptor_lake/Kconfig"
osource "/home/lpl/zephyr/soc/intel/lakemont/Kconfig"
osource "/home/lpl/zephyr/soc/intel/intel_socfpga_std/Kconfig"
osource "/home/lpl/zephyr/soc/intel/intel_socfpga/Kconfig"
osource "/home/lpl/zephyr/soc/intel/intel_niosv/Kconfig"
osource "/home/lpl/zephyr/soc/intel/intel_ish/Kconfig"
osource "/home/lpl/zephyr/soc/intel/intel_adsp/Kconfig"
osource "/home/lpl/zephyr/soc/intel/elkhart_lake/Kconfig"
osource "/home/lpl/zephyr/soc/intel/atom/Kconfig"
osource "/home/lpl/zephyr/soc/intel/apollo_lake/Kconfig"
osource "/home/lpl/zephyr/soc/intel/alder_lake/Kconfig"
osource "/home/lpl/zephyr/soc/infineon/cat3/Kconfig"
osource "/home/lpl/zephyr/soc/infineon/cat1c/Kconfig"
osource "/home/lpl/zephyr/soc/infineon/cat1b/Kconfig"
osource "/home/lpl/zephyr/soc/infineon/cat1a/Kconfig"
osource "/home/lpl/zephyr/soc/gd/gd32/Kconfig"
osource "/home/lpl/zephyr/soc/gaisler/leon3/Kconfig"
osource "/home/lpl/zephyr/soc/gaisler/gr716a/Kconfig"
osource "/home/lpl/zephyr/soc/espressif/Kconfig"
osource "/home/lpl/zephyr/soc/ene/kb1200/Kconfig"
osource "/home/lpl/zephyr/soc/ene/kb106x/Kconfig"
osource "/home/lpl/zephyr/soc/efinix/sapphire/Kconfig"
osource "/home/lpl/zephyr/soc/cdns/xtensa_sample_controller/Kconfig"
osource "/home/lpl/zephyr/soc/cdns/sample_controller32/Kconfig"
osource "/home/lpl/zephyr/soc/cdns/dc233c/Kconfig"
osource "/home/lpl/zephyr/soc/brcm/bcmvk/Kconfig"
osource "/home/lpl/zephyr/soc/brcm/bcm2712/Kconfig"
osource "/home/lpl/zephyr/soc/brcm/bcm2711/Kconfig"
osource "/home/lpl/zephyr/soc/bflb/Kconfig"
osource "/home/lpl/zephyr/soc/atmel/sam0/Kconfig"
osource "/home/lpl/zephyr/soc/atmel/sam/Kconfig"
osource "/home/lpl/zephyr/soc/aspeed/Kconfig"
osource "/home/lpl/zephyr/soc/arm/Kconfig"
osource "/home/lpl/zephyr/soc/arm/beetle/Kconfig"
osource "/home/lpl/zephyr/soc/antmicro/myra/Kconfig"
osource "/home/lpl/zephyr/soc/andestech/Kconfig"
osource "/home/lpl/zephyr/soc/amd/acp_6_0/Kconfig"
osource "/home/lpl/zephyr/soc/ambiq/Kconfig"
osource "/home/lpl/zephyr/soc/aesc/Kconfig"
osource "/home/lpl/zephyr/soc/adi/max32/Kconfig"
```

## west.yml
```yaml
# If this file is modified, you must also rebuild the dev container as we pre-bake the west projects into the image.
# See docs/pushing-new-dev-container-image.md for instructions.
manifest:
  remotes:
    - name: zephyrproject-rtos
      url-base: https://github.com/zephyrproject-rtos

  projects:
    - name: zephyr
      remote: zephyrproject-rtos
      revision: v4.2.0
      import:
        name-allowlist:
          - cmsis_6
          - hal_nxp
          - hal_stm32
          - nanopb

    - name: Arduino-Core-Zephyr
      path: modules/lib/Arduino-Zephyr-API
      revision: main
      url: https://github.com/zephyrproject-rtos/arduino-core-zephyr
```
