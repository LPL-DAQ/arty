## CMakeLists.txt
```
cmake_minimum_required(VERSION 3.13.1)
set(CONFIG_MCUX_COMPONENT_driver.lpspi ON)
find_package(Zephyr REQUIRED HINTS $ENV{ZEPHYR_BASE})

# For god's sake, why isn't this set automatically?
set(CMAKE_CPP_COMPILER "${CROSS_COMPILE}g++")

message(STATUS "C compiler: ${CMAKE_C_COMPILER}")
message(STATUS "C++ compiler: ${CMAKE_CPP_COMPILER}")

project(app)

# Add nanopb dependency
list(APPEND CMAKE_MODULE_PATH ${ZEPHYR_BASE}/modules/nanopb)
include(nanopb)

zephyr_include_directories(src)
zephyr_nanopb_sources(app ../api/clover.proto)

add_subdirectory(src)
```

## Kconfig
```
menu "Zephyr"
source "Kconfig.zephyr"
endmenu

menu "Application options"

choice IMPLEMENTATION
    prompt "Ranger or Hornet"
    default RANGER

config RANGER
    bool "Ranger implementation"

config HORNET
    bool "Hornet implementation"

endchoice


choice LOGGING_BACKEND
    prompt "UART or USB"
    default USB_LOGGING

config USB_LOGGING
    bool "Log via USB. Does not capture crash logs, kinda flakey."

config UART_LOGGING
    bool "Log via UART. Captures crash logs and quite reliable."

endchoice


config BLINK_LED
    bool "Whether a blinky LED is available"
    default n


config ETHERNET
    bool "Whether ethernet is available"
    default y

config RF
    bool "Whether RF is available"
    default y

config LIDAR
    bool "Whether LIDARs are available"
    default y

config IMU
    bool "Whether IMU is available"
    default y

config GNSS
    bool "Whether GNSS is available"
    default y

config ANALOG_SENSORS
    bool "Whether analog sensors are available"
    default y

config VALVES
    bool "Whether GPIO-controlled valves are available"
    default y if RANGER

config THROTTLE_VALVES
    bool "Whether throttle valves are available"
    default y if RANGER

config TVC_ACTUATORS
    bool "Whether TVC linear actuators are available"
    default y if RANGER

config PWM_ACTUATORS
    bool "Whether PWM actuators are available"
    default y if HORNET


config RANGER_THROTTLE
    bool "Whether ranger-variant throttle is available"
    depends on RANGER
    depends on ANALOG_SENSORS
    depends on THROTTLE_VALVES
    default y if RANGER
    select THROTTLE

config RANGER_TVC
    bool "Whether ranger-variant TVC is available"
    depends on RANGER
    depends on TVC_ACTUATORS
    default y if RANGER
    select TVC

config RANGER_RCS
    bool "Whether ranger-variant TVC is available"
    depends on RANGER
    depends on ANALOG_SENSORS
    depends on VALVES
    default y if RANGER
    select RCS


config HORNET_THROTTLE
    bool "Whether hornet-variant throttle is available"
    depends on HORNET
    depends on PWM_ACTUATORS
    default y if HORNET
    select THROTTLE

config HORNET_TVC
    bool "Whether hornet-variant TVC is available"
    depends on HORNET
    depends on PWM_ACTUATORS
    default y if HORNET
    select TVC

config HORNET_RCS
    bool "Whether hornet-variant TVC is available"
    depends on HORNET
    depends on PWM_ACTUATORS
    default y if HORNET
    select RCS


config THROTTLE
    bool "Whether any throttle implementation is available"

config TVC
    bool "Whether any TVC implementation is available"

config RCS
    bool "Whether any RCS implementation is available"


config STATIC_FIRE
    bool "Whether a static fire sequence is possible"
    default y if THROTTLE && TVC


config FLIGHT
    bool "Whether full flight control is available"
    depends on THROTTLE
    depends on TVC
    depends on RCS
    depends on IMU
    depends on LIDAR
    depends on GNSS

rsource "Kconfig.estimator"

endmenu

module = CLOVER
module-str = CLOVER
source "subsys/logging/Kconfig.template.log_config"
```

## Kconfig.estimator
```
config USE_ZAXIS_EKF_FOR_ALTITUDE
    bool "Use the vertical EKF for altitude and vertical velocity"
    default y
    help
      Turn off for ground testing to pass raw Javad altitude and vertical
      velocity straight through. Keep on for flight.
```

## sample.yaml
```
# This file is provided so that the application can be compiled using Twister,
# the Zephyr testing tool. In this file, multiple combinations can be specified,
# so that you can easily test all of them locally or in CI.
sample:
  description: Throttle dev2
  name: throttle
common:
  build_only: true
  integration_platforms:
    - custom_plank
    - nucleo_f302r8
tests:
  app.default: { }
  app.debug:
    extra_overlay_confs:
      - debug.conf
```

## prj.conf
```kconfig
CONFIG_CPP=y
CONFIG_STD_CPP2B=y  # Applies std=C++23
CONFIG_LOG_MODE_IMMEDIATE=y
CONFIG_REQUIRES_FULL_LIBC=y
CONFIG_GLIBCXX_LIBCPP=y
CONFIG_NEWLIB_LIBC=y
CONFIG_CBPRINTF_LIBC_SUBSTS=y

# No need to reserve heap space, we don't use it and a violation here causes a fatal error early in bootup.
CONFIG_NEWLIB_LIBC_MIN_REQUIRED_HEAP_SIZE=0

CONFIG_MAIN_STACK_SIZE=4096

# Set the following if you're connected directly via ethernet.
CONFIG_NET_CONFIG_MY_IPV4_ADDR="169.254.99.99"
CONFIG_NET_CONFIG_MY_IPV4_NETMASK="255.255.0.0"

# Set the following if you're connected via the DAQ box router.
# CONFIG_NET_CONFIG_MY_IPV4_ADDR="192.168.0.150"
# CONFIG_NET_CONFIG_MY_IPV4_NETMASK="255.255.255.0"
# CONFIG_NET_CONFIG_MY_IPV4_GW="192.168.0.1"

# enable some variable setter visability for the sake of unit tests
CONFIG_TEST=y

# Set to n for ground testing to pass raw Javad altitude through instead of the vertical EKF.
CONFIG_USE_ZAXIS_EKF_FOR_ALTITUDE=y


# Add nanopb, used to serialize and deserialize requests and responses for the command server.
CONFIG_NANOPB=y

# Enable preemptive multithreading
CONFIG_TIMESLICING=y
CONFIG_TIMESLICE_SIZE=1
CONFIG_TIMESLICE_PRIORITY=0

# Enable networking
CONFIG_NETWORKING=y
CONFIG_NET_UDP=y
CONFIG_NET_TCP=y
CONFIG_NET_IPV4=y
CONFIG_NET_LOG=y
CONFIG_NET_CONFIG_SETTINGS=y
CONFIG_NET_CONFIG_NEED_IPV4=y
CONFIG_NET_L2_ETHERNET=y
CONFIG_NET_CONFIG_INIT_TIMEOUT=0
CONFIG_NET_CONTEXT_RCVTIMEO=y
CONFIG_NET_SOCKETS=y
CONFIG_NET_TX_STACK_SIZE=4096
CONFIG_NET_RX_STACK_SIZE=4096
CONFIG_NET_PKT_RX_COUNT=64
CONFIG_NET_PKT_TX_COUNT=64
CONFIG_NET_BUF_RX_COUNT=64
CONFIG_NET_BUF_TX_COUNT=64
CONFIG_NET_MAX_CONN=64
CONFIG_NET_MAX_CONTEXTS=64
CONFIG_NET_CONNECTION_MANAGER=y
CONFIG_NET_TCP_TIME_WAIT_DELAY=0
CONFIG_POSIX_NETWORKING=y  # Links POSIX networking functions like inet_addr

# Allow connection drop to be detected.
CONFIG_NET_TCP_KEEPALIVE=y
CONFIG_NET_TCP_KEEPINTVL_DEFAULT=10
CONFIG_NET_TCP_KEEPIDLE_DEFAULT=10
CONFIG_NET_TCP_KEEPCNT_DEFAULT=6

CONFIG_INIT_STACKS=y

CONFIG_SYSTEM_WORKQUEUE_STACK_SIZE=4096

CONFIG_SERIAL=y
CONFIG_CONSOLE=y
CONFIG_UART_CONSOLE=y
CONFIG_PRINTK=y
CONFIG_UART_INTERRUPT_DRIVEN=y
CONFIG_GPIO=y
CONFIG_RING_BUFFER=y

CONFIG_LOG=y
CONFIG_LOG_DEFAULT_LEVEL=3
# CONFIG_LOG_BACKEND_UART=y
CONFIG_LOG_MODE_IMMEDIATE=y
CONFIG_LOG_BACKEND_SHOW_COLOR=n  # Disables control characters used for ANSI color formatting

# Override all log modules to write warn and above.
# CONFIG_LOG_OVERRIDE_LEVEL=4

# Uncomment to configure a periodic console message of thread CPU/stack usage.
# CONFIG_THREAD_ANALYZER=y
# CONFIG_THREAD_ANALYZER_AUTO=y
# CONFIG_THREAD_ANALYZER_AUTO_INTERVAL=5
# CONFIG_THREAD_NAME=y
```

## chrony.conf
```kconfig
#Serve time based on the local system clock
#tells Chrony to act as an NTP server
local stratum 8

#Allow clients on your local subnet to query the server
allow 169.254.0.0/24

# Optional: Bind Chrony to the specific Ethernet interface
# This prevents it from trying to serve time over Wi-Fi or other adapters.
bindaddress 169.254.99.99

# 5. Standard system files
driftfile /var/lib/chrony/chrony.drift
makestep 1 3
rtcsync
```

## src/main.cpp
```c
#include <zephyr/drivers/uart.h>
#include <zephyr/kernel.h>
#include <zephyr/logging/log.h>
#include <zephyr/net/net_if.h>
#include <zephyr/net/net_pkt.h>
#include <zephyr/net/socket.h>
#include <zephyr/sys/util.h>
#include <zephyr/usb/usb_device.h>

#include "BlinkLed.h"
#include "config.h"
#include "Controller.h"
#include "ThrottleValve.h"
#include "Valves.h"
#include "sensors/AnalogSensors.h"
#include "sensors/Gnss.h"
#include "sensors/Lidar.h"
#include "sensors/VectornavIMU.h"
#include "server.h"
#include "watchdog.h"

LOG_MODULE_REGISTER(main, CONFIG_LOG_DEFAULT_LEVEL);

int main(void)
{
    // Upon Startup - Evaluate the reboot cause before doing anything else.
    // This also calls the on_watchdog_reboot() function if the cause was determined to be a watchdog reset.
    const Watchdog::RebootCheckResult reboot = Watchdog::evaluate_reboot_cause();

#ifdef CONFIG_USB_LOGGING
    // Serial over USB setup
    if (usb_enable(nullptr)) {
        LOG_ERR("USB is not enabled.");
        while (1) {
        }
    }

    // Try connecting to serial over usb for 3 seconds.
    const device* usb_dev = DEVICE_DT_GET(DT_CHOSEN(zephyr_console));
    for (int i = 0; i < 30; ++i) {
        k_sleep(K_MSEC(100));

        uint32_t dtr = 0;
        uart_line_ctrl_get(usb_dev, UART_LINE_CTRL_DTR, &dtr);
        if (dtr) {
            LOG_INF("Starting server");
            break;
        }
    }
#elifdef CONFIG_UART_LOGGING
    const device* uart = DEVICE_DT_GET(DT_CHOSEN(zephyr_console));
    if (!device_is_ready(uart)) {
        LOG_ERR("Failed to check uart log device readiness: %s", Error::from_device_not_ready(uart).build_message().c_str());
    }
#else
#warning "No logging backend set -- should use either CONFIG_USB_LOGGING or CONFIG_UART_LOGGING"
#endif

    // Now that logging has been established, print the reboot cause for the user to view.
    // Note: If we want more sophisticated handling for the two error cases, they can be added here. 
    // 1) reboot.cause_available. If this is false then we don't know why the teensy restarted.
    // 2) reboot.clear_error. If this is non-zero then we were unable to clear the reset reason. Just good to have documented.
    if (!reboot.cause_available) {
        LOG_WRN("Reset cause unavailable (%d)", reboot.read_error);
    } else {
        if (reboot.watchdog_reset) {
            LOG_WRN("Watchdog reset detected");
        }

        if (reboot.clear_error != 0) {
            LOG_WRN("Failed to clear reset flags (%d); "
                    "future checks may include an older reset",
                    reboot.clear_error);
        }
    }

    // Initialize the Watchdog with the appropriate timeout (established in config.h)
    if (!Watchdog::init(WATCHDOG_TIMEOUT)) {
        LOG_ERR("Failed to initialize Watchdog. Aborting boot.");
        return 0;
    }

#ifdef CONFIG_BLINK_LED
    if (auto result = BlinkLed::init(); !result) {
        LOG_ERR("Failed to initialize blink LED: %s", result.error().build_message().c_str());
        return 1;
    }
#endif

#ifdef CONFIG_LIDAR
    LOG_INF("Initializing Lidar 1");
    if (auto result = Lidar1::init(); !result) {
        LOG_ERR("Failed to initialize Lidar 1: %s", result.error().build_message().c_str());
        return 0;
    }

    LOG_INF("Initializing Lidar 2");
    if (auto result = Lidar2::init(); !result) {
        LOG_ERR("Failed to initialize Lidar 2: %s", result.error().build_message().c_str());
        return 0;
    }
#endif

#ifdef CONFIG_IMU
    LOG_INF("Initializing IMU");
    if (auto result = VectornavImu::init(); !result) {
        LOG_ERR("Failed to initialize IMU: %s", result.error().build_message().c_str());
        return 0;
    }
#endif

#ifdef CONFIG_GNSS
    LOG_INF("Initializing GNSS");
    if (auto result = Gnss::init(); !result) {
        LOG_ERR("Failed to initialize GNSS: %s", result.error().build_message().c_str());
        return 0;
    }
    Gnss::start_sense();
#endif

#ifdef CONFIG_ANALOG_SENSORS
    LOG_INF("Initializing analog sensors");
    if (auto result = AnalogSensors::init(); !result) {
        LOG_ERR("Failed to initialize analog sensors: %s", result.error().build_message().c_str());
        return 0;
    }
#endif

#ifdef CONFIG_VALVES
    LOG_INF("Initializing general valves");
    if (auto result = Valves::init(); !result) {
        LOG_ERR("Failed to initialize general valves: %s", result.error().build_message().c_str());
        return 0;
    }
#endif

#ifdef CONFIG_THROTTLE_VALVES
    LOG_INF("Initializing fuel throttle valve");
    if (auto result = FuelValve::init(); !result) {
        LOG_ERR("Failed to initialize fuel throttle valve: %s", result.error().build_message().c_str());
        return 0;
    }

    LOG_INF("Initializing lox throttle valve");
    if (auto result = LoxValve::init(); !result) {
        LOG_ERR("Failed to initialize lox throttle valve: %s", result.error().build_message().c_str());
        return 0;
    }
#endif

    LOG_INF("Initializing Controller");
    if (auto result = Controller::init(); !result) {
        LOG_ERR("Failed to initialize Controller: %s", result.error().build_message().c_str());
        return 0;
    }

    k_sleep(K_MSEC(500));
    LOG_INF("Starting server");
    serve_connections();
}
```

## src/AbortState.cpp
```c
#include "AbortState.h"

void AbortState::init() {
    // Controller handles actuation now
}

ControllerOutput AbortState::tick(uint32_t current_time, uint32_t entry_time, float default_fuel, float default_lox) {
    ControllerOutput out;

    // Drive valves to nominal safe positions
    out.set_fuel = true;
    out.fuel_pos = default_fuel;

    out.set_lox = true;
    out.lox_pos = default_lox;

    // Run for ~0.5s before allowing state transition back to idle
    if (current_time - entry_time > 500) {
        out.next_state = SystemState_STATE_IDLE;
    } else {
        out.next_state = SystemState_STATE_ABORT;
    }

    return out;
}
```

## src/AbortState.h
```c
#ifndef APP_ABORT_STATE_H
#define APP_ABORT_STATE_H

#include "Controller.h"

namespace AbortState {
    void init();
    ControllerOutput tick(uint32_t current_time, uint32_t entry_time, float default_fuel, float default_lox);
}

#endif // APP_ABORT_STATE_H
```

## src/AnalogSensors.cpp
```c
#include "AnalogSensors.h"

#include <zephyr/kernel.h>
#include <zephyr/device.h>
#include <zephyr/drivers/adc.h>
#include <zephyr/devicetree.h>
#include <zephyr/sys/util.h>

#define USER_NODE DT_PATH(zephyr_user)

static const struct adc_dt_spec adc_specs[] = {
    ADC_DT_SPEC_GET_BY_NAME(USER_NODE, bank1_ain0),
    ADC_DT_SPEC_GET_BY_NAME(USER_NODE, bank1_ain1),
    ADC_DT_SPEC_GET_BY_NAME(USER_NODE, bank2_ain0),
    ADC_DT_SPEC_GET_BY_NAME(USER_NODE, bank2_ain1),
};

static int read_one_channel(const struct adc_dt_spec *spec, int16_t *sample)
{
    struct adc_sequence seq = {};
    adc_sequence_init_dt(spec, &seq);

    seq.buffer = sample;
    seq.buffer_size = sizeof(*sample);
    seq.calibrate = false;
    seq.oversampling = 0;

    return adc_read_dt(spec, &seq);
}

std::expected<void, Error> AnalogSensors::init()
{
    for (size_t i = 0; i < ARRAY_SIZE(adc_specs); ++i) {
        if (!adc_is_ready_dt(&adc_specs[i])) {
            return std::unexpected(Error::from_code(-ENODEV));
        }

        int ret = adc_channel_setup_dt(&adc_specs[i]);
        if (ret < 0) {
            return std::unexpected(Error::from_code(ret));
        }
    }

    return {};
}

std::expected<void, Error> AnalogSensors::handle_configure_analog_sensors(
    const ConfigureAnalogSensorsRequest& req)
{
    (void)req;
    return {};
}

void AnalogSensors::start_sense()
{
}

std::optional<std::pair<AnalogSensorReadings, float>> AnalogSensors::read()
{
    int16_t raw[ARRAY_SIZE(adc_specs)] = {0};

    for (size_t i = 0; i < ARRAY_SIZE(adc_specs); ++i) {
        int ret = read_one_channel(&adc_specs[i], &raw[i]);
        if (ret < 0) {
            return std::nullopt;
        }
    }

    AnalogSensorReadings readings = AnalogSensorReadings_init_zero;

    readings.has_pt001 = true;
    readings.pt001 = static_cast<float>(raw[0]);

    readings.has_pt002 = true;
    readings.pt002 = static_cast<float>(raw[1]);

    readings.has_pt003 = true;
    readings.pt003 = static_cast<float>(raw[2]);

    readings.has_pt004 = true;
    readings.pt004 = static_cast<float>(raw[3]);

    float timestamp_s = static_cast<float>(k_uptime_get()) / 1000.0f;
    return std::make_pair(readings, timestamp_s);
}
```

## src/AnalogSensors.h
```c
#pragma once

#include "Error.h"
#include "clover.pb.h"

#include <expected>
#include <optional>
#include <utility>

namespace AnalogSensors {

std::expected<void, Error> init();

std::expected<void, Error> handle_configure_analog_sensors(
    const ConfigureAnalogSensorsRequest& req);

void start_sense();

std::optional<std::pair<AnalogSensorReadings, float>> read();

} // namespace AnalogSensors
```

## src/BlinkLed.cpp
```c
#include "BlinkLed.h"
#include "config.h"
#include <zephyr/drivers/gpio.h>
#include <zephyr/logging/log.h>

LOG_MODULE_REGISTER(BlinkLed, CONFIG_LOG_DEFAULT_LEVEL);

static constexpr gpio_dt_spec blink_gpio = GPIO_DT_SPEC_GET(DT_PATH(zephyr_user), blink_gpios);

static void blink()
{
    while (true) {
        k_sleep(K_MSEC(1000));
        gpio_pin_toggle_dt(&blink_gpio);
    }
}

K_THREAD_DEFINE(blink_thread, 128, blink, nullptr, nullptr, nullptr, BLINK_THREAD_PRIORITY, 0, 0);

std::expected<void, Error> BlinkLed::init()
{
    if (!device_is_ready(blink_gpio.port)) {
        return std::unexpected(Error::from_device_not_ready(blink_gpio.port).context("blink GPIO not ready"));
    }

    int err = gpio_pin_configure_dt(&blink_gpio, GPIO_OUTPUT_ACTIVE);
    if (err) {
        return std::unexpected(Error::from_code(err).context("failed to set up blink LED"));
    }

    err = gpio_pin_set_dt(&blink_gpio, 1);
    if (err) {
        return std::unexpected(Error::from_code(err).context("failed to set blink LED to on"));
    }

    return {};
}
```

## src/BlinkLed.h
```c
#pragma once

#include "Error.h"
#include <expected>

#ifdef CONFIG_BLINK_LED

namespace BlinkLed {
std::expected<void, Error> init();
}

#endif  // CONFIG_BLINK_LED
```

## src/CalibrationState.cpp
```c
#include "CalibrationState.h"
#include <zephyr/logging/log.h>
#include <array>
LOG_MODULE_REGISTER(calibration_state);


namespace {
    enum class CalPhase {
        SEEK_HARDSTOP,
        BACK_OFF,
        END_MOVEMENT,
        POWER_OFF,
        REPOWER,
        COMPLETE,
        MEASURE,
        ERROR
    };



    static CalPhase phase = CalPhase::SEEK_HARDSTOP;
    float fuel_target_position = 0.0f;
    float fuel_hardstop_position = 0.0f;
    bool fuel_found_stop = false;
    float lox_target_position = 0.0f;
    float lox_hardstop_position = 0.0f;
    bool lox_found_stop = false;
    float step_size = 0.002f; // in degrees, how much to move per step
    int num_reps = 1; // number of times to hit the hard
    int rep_counter = 0;
    float pos_error_limit = 10.0f; // positional error limit
    float backup_dist = 5.0f;
    float fuel_starting_error = 0.0f;
    float lox_starting_error = 0.0f;

    uint32_t power_cycle_timestamp = 0;
}



void CalibrationState::init(float fuel_pos, float fuel_pos_enc, float lox_pos, float lox_pos_enc) {
    // Controller handles actuation now
    phase = CalPhase::SEEK_HARDSTOP;
    rep_counter = 0;
    fuel_found_stop = false;
    lox_found_stop = false;
    fuel_hardstop_position = 0.0f;
    lox_hardstop_position = 0.0f;
    power_cycle_timestamp = 0;

    fuel_target_position = fuel_pos_enc;
    lox_target_position = lox_pos_enc;

    fuel_starting_error = fuel_pos - fuel_pos_enc;
    lox_starting_error = lox_pos - lox_pos_enc;


}



std::pair<ControllerOutput, CalibrationData> CalibrationState::tick(uint32_t timestamp,float fuel_pos, float lox_pos,float fuel_pos_enc, float lox_pos_enc) {
    ControllerOutput out{};
    CalibrationData data{};

    switch (phase) {
        case CalPhase::SEEK_HARDSTOP:
            seek_hardstop(out, fuel_pos, fuel_pos_enc,
                            lox_pos, lox_pos_enc);
            break;
        case CalPhase::BACK_OFF:
            break;
        case CalPhase::END_MOVEMENT:
            end_movement(out, timestamp);
            break;
        case CalPhase::POWER_OFF:
            power_off(out, timestamp);
            break;
        case CalPhase::REPOWER:
            repower(out, timestamp);
            break;
        case CalPhase::COMPLETE:
            complete(out, timestamp);
            break;
        case CalPhase::MEASURE:
            measure(out, fuel_pos, fuel_pos_enc, lox_pos, lox_pos_enc);
            break;
        case CalPhase::ERROR:
            error(out, timestamp);
            break;
        default:
            break;
    }
    data.fuel_pos = fuel_pos;
    data.fuel_pos_enc = fuel_pos_enc;
    data.fuel_found_hardstop = fuel_found_stop;
    data.fuel_hardstop_pos = fuel_hardstop_position;
    data.lox_pos = lox_pos;
    data.lox_pos_enc = lox_pos_enc;
    data.lox_found_hardstop = lox_found_stop;
    data.lox_hardstop_pos = lox_hardstop_position;
    data.fuel_err = fuel_pos - (fuel_pos_enc+ fuel_starting_error);
    data.lox_err = lox_pos - (lox_pos_enc + lox_starting_error);
    data.cal_phase = get_phase_id();
    data.fuel_target_position = fuel_target_position;
    data.lox_target_position = lox_target_position;


    return std::make_pair(out, data);
}
void CalibrationState::seek_hardstop(ControllerOutput& out, float fuel_pos,float fuel_pos_enc,float lox_pos, float lox_pos_enc) {
    out.set_fuel = true;
    out.set_lox = true;

    if (!lox_found_stop
        && std::abs(lox_pos - (lox_starting_error + lox_pos_enc)) <= pos_error_limit
    ) {
            lox_target_position += step_size / (rep_counter+1);
            out.lox_pos = lox_target_position; // move towards stop, but slow down in later loops
    } else { // when it reaches
        lox_found_stop = true;
        lox_hardstop_position = lox_pos_enc;
        out.lox_pos = lox_pos_enc; // hold position once we find the hardstop
    }


    if (!fuel_found_stop
        && std::abs(fuel_pos - (fuel_starting_error + fuel_pos_enc)) <= pos_error_limit
    ) {
            fuel_target_position += step_size / (rep_counter+1);
            out.fuel_pos = fuel_target_position; // move towards stop, but slow down in later loops
    } else { // when it reaches
        fuel_found_stop = true;
        fuel_hardstop_position = fuel_pos_enc;
        out.fuel_pos = fuel_pos_enc; // hold position once we find the hardstop
    }

    // if both reached, move away from stop
    if (fuel_found_stop && lox_found_stop) {
        fuel_found_stop = false;
        lox_found_stop = false;
        rep_counter++;
        phase = CalPhase::END_MOVEMENT;
    }
    out.next_state = SystemState_STATE_CALIBRATION;
}

void CalibrationState::end_movement(ControllerOutput& out, uint32_t timestamp) {
    FuelValve::reset_pos(fuel_hardstop_position);
    LoxValve::reset_pos(lox_hardstop_position);

    out.set_fuel = false;
    out.set_lox = false;
    if (power_cycle_timestamp == 0){
        power_cycle_timestamp = timestamp;
    }
    else if (timestamp - power_cycle_timestamp >= 1000) {
        phase = CalPhase::POWER_OFF;
    }
    out.next_state = SystemState_STATE_CALIBRATION;
}

void CalibrationState::power_off(ControllerOutput& out, uint32_t timestamp) {
    out.fuel_on = false;
    out.lox_on = false;
    if (timestamp - power_cycle_timestamp >= 4000) {
        phase = CalPhase::REPOWER;
    }
    out.next_state = SystemState_STATE_CALIBRATION;
}

void CalibrationState::repower(ControllerOutput& out, uint32_t timestamp) {
    // while default, this is just explicit for clarity
    out.fuel_on = true;
    out.lox_on = true;
    if (timestamp - power_cycle_timestamp >= 5000) {
        phase = CalPhase::COMPLETE;
    }
    out.next_state = SystemState_STATE_CALIBRATION;
}

void CalibrationState::complete(ControllerOutput& out, uint32_t timestamp) {
    out.set_fuel = true;
    out.set_lox = true;
    out.fuel_pos = 95.0f;
    out.lox_pos = 95.0f;
    out.reset_fuel = true;
    out.reset_fuel_pos = 95;
    out.reset_lox = true;
    out.reset_lox_pos = 95;

    fuel_found_stop = false;
    lox_found_stop = false;
    fuel_starting_error = 0;
    lox_starting_error = 0;
    fuel_target_position = 95;
    lox_target_position = 95;


    // should be idle, but this is for testing
    out.next_state = SystemState_STATE_CALIBRATION;
    if (timestamp - power_cycle_timestamp >= 6500) {
        out.next_state = SystemState_STATE_IDLE;
        phase = CalPhase::COMPLETE;
    }


}

void CalibrationState::error(ControllerOutput& out, uint32_t timestamp) {
    // In error, turn off drivers and do not try to move
    out.set_fuel = false;
    out.set_lox = false;
    out.fuel_on = false;
    out.lox_on = false;

    if (power_cycle_timestamp == 0){
        power_cycle_timestamp = timestamp;
    }
}

void CalibrationState::measure(ControllerOutput& out, float fuel_pos,float fuel_pos_enc,float lox_pos, float lox_pos_enc) {
    out.set_fuel = true;
    out.set_lox = true;



    if (lox_pos_enc > 10){
        lox_target_position -= step_size*3;
        out.lox_pos = lox_target_position; // move towards stop, but slow down in later loops
    }
    else if (!lox_found_stop
        && std::abs(lox_pos - (lox_starting_error + lox_pos_enc)) <= pos_error_limit
    ) {
            lox_target_position -= step_size;
            out.lox_pos = lox_target_position; // move towards stop, but slow down in later loops

    } else { // when it reaches
        lox_found_stop = true;
        lox_hardstop_position = lox_pos_enc;
        out.lox_pos = lox_pos_enc; // hold position once we find the hardstop
    }

    // // if loxside hasnt reached
    // if (!lox_found_stop && std::abs(lox_pos - lox_pos_enc) <= pos_error_limit) {
    //     lox_target_position += step_size / (rep_counter+1);
    //     out.lox_pos = lox_target_position; // move towards stop, but slow down in later loops
    // } else { // when it reaches
        fuel_found_stop = true;
        fuel_hardstop_position = fuel_pos_enc;
        out.fuel_pos = fuel_pos_enc; // hold position once we find the hardstop
    // }


    // if both reached, move away from stop
    out.next_state = SystemState_STATE_CALIBRATION;

    if (fuel_found_stop && lox_found_stop) {
        fuel_target_position = fuel_hardstop_position;
        lox_target_position = lox_hardstop_position;
        // LOG_INF("err: %f, pos %f, enc %f",  std::abs(lox_pos - (lox_starting_error + lox_pos_enc)), lox_pos, lox_pos_enc);
        // LOG_INF("Fuel hardstop at %f, Lox hardstop at %f", fuel_hardstop_position, lox_hardstop_position);
        out.next_state = SystemState_STATE_IDLE;
    }
}

int CalibrationState::get_phase_id() {
    switch (phase) {
        case CalPhase::SEEK_HARDSTOP:
            return 0;
        case CalPhase::BACK_OFF:
            return 1;
        case CalPhase::END_MOVEMENT:
            return 2;
        case CalPhase::POWER_OFF:
            return 3;
        case CalPhase::REPOWER:
            return 4;
        case CalPhase::COMPLETE:
            return 5;
        case CalPhase::MEASURE:
            return 6;
        case CalPhase::ERROR:
            return 7;
        default:
            return -1; // Unknown phase
    }
}
```

## src/CalibrationState.h
```c
#ifndef APP_CALIBRATION_STATE_H
#define APP_CALIBRATION_STATE_H

#include "Controller.h"
#include "ThrottleValve.h"

#include <cmath>

namespace CalibrationState {




    void init( float fuel_pos, float fuel_pos_enc,float lox_pos, float lox_pos_enc);
    void seek_hardstop(ControllerOutput& out, float fuel_pos, float fuel_pos_enc,float lox_pos, float lox_pos_enc);
    void back_off(ControllerOutput& out ,float fuel_pos_enc,float lox_pos_enc);
    void end_movement(ControllerOutput& out, uint32_t timestamp);
    void power_off(ControllerOutput& out, uint32_t timestamp);
    void repower(ControllerOutput& out, uint32_t timestamp);
    void complete(ControllerOutput& out, uint32_t timestamp);
    void measure(ControllerOutput& out, float fuel_pos,float fuel_pos_enc,float lox_pos, float lox_pos_enc);
    void error(ControllerOutput& out, uint32_t timestamp);
    int get_phase_id();
    std::pair<ControllerOutput, CalibrationData> tick(uint32_t timestamp,float fuel_pos, float lox_pos,float fuel_pos_enc, float lox_pos_enc);
}

#endif // APP_CALIBRATION_STATE_H
```

## src/ClosedLoopState.cpp
```c
#include "ClosedLoopState.h"
#include "LookupTable.h"
#include <zephyr/logging/log.h>

LOG_MODULE_DECLARE(Controller, LOG_LEVEL_INF);

void ClosedLoopState::init() {
    LOG_INF("Entering Closed Loop Throttle Mode");
}

ControllerOutput ClosedLoopState::tick(bool has_ptc, float ptc_pressure) {
    ControllerOutput out{};

    if (!has_ptc) {
        LOG_ERR("Lost feedback sensor! Aborting closed loop.");
        out.next_state = SystemState_STATE_ABORT;
        return out;
    }

    // Calculate target throttle via lookup table
    float target_valve_pos = interpolate_throttle(ptc_pressure);

    out.set_fuel = true;
    out.fuel_pos = target_valve_pos;

    out.set_lox = true;
    out.lox_pos = target_valve_pos;

    out.next_state = SystemState_STATE_CLOSED_LOOP_THROTTLE;

    return out;
}
```

## src/ClosedLoopState.h
```c
#ifndef APP_CLOSED_LOOP_STATE_H
#define APP_CLOSED_LOOP_STATE_H

#include "Controller.h"

namespace ClosedLoopState {
    void init();
    ControllerOutput tick(bool has_ptc, float ptc_pressure);
}

#endif // APP_CLOSED_LOOP_STATE_H
```

## src/Controller.h
```c
#pragma once

#include "Error.h"
#include "Trace.h"
#include "clover.pb.h"
#include "sensors/AnalogSensors.h"
#include <expected>
#include <zephyr/kernel.h>

namespace Controller {
constexpr float ABORT_TIME_MSEC = 500;
constexpr uint64_t NSEC_PER_CONTROL_TICK = 1'500'000;  // 1 ms
constexpr float SEC_PER_CONTROL_TICK = NSEC_PER_CONTROL_TICK * 1e-9f;

std::expected<void, Error> init();
DataPacket get_next_data_packet();

// Reset valve position
std::expected<void, Error> handle_throttle_reset_valve_position(const ThrottleResetValvePositionRequest& req);

// Request handlers
std::expected<void, Error> handle_abort(const AbortRequest& req);
std::expected<void, Error> handle_halt(const HaltRequest& req);
std::expected<void, Error> handle_unprime(const UnprimeRequest& req);

// Throttle
std::expected<void, Error> handle_calibrate_throttle_valve(const CalibrateThrottleValveRequest& req);

std::expected<void, Error> handle_load_throttle_valve_sequence(const LoadThrottleValveSequenceRequest& req);
std::expected<void, Error> handle_start_throttle_valve_sequence(const StartThrottleValveSequenceRequest& req);

std::expected<void, Error> handle_load_throttle_sequence(const LoadThrottleSequenceRequest& req);
std::expected<void, Error> handle_start_throttle_sequence(const StartThrottleSequenceRequest& req);

// TVC
std::expected<void, Error> handle_calibrate_tvc(const CalibrateTvcRequest& req);

std::expected<void, Error> handle_load_tvc_sequence(const LoadTvcSequenceRequest& req);
std::expected<void, Error> handle_start_tvc_sequence(const StartTvcSequenceRequest& req);

// RCS
std::expected<void, Error> handle_load_rcs_valve_sequence(const LoadRcsValveSequenceRequest& req);
std::expected<void, Error> handle_start_rcs_valve_sequence(const StartRcsValveSequenceRequest& req);

std::expected<void, Error> handle_load_rcs_sequence(const LoadRcsSequenceRequest& req);
std::expected<void, Error> handle_start_rcs_sequence(const StartRcsSequenceRequest& req);

// Static flight (TVC + Throttle)
std::expected<void, Error> handle_load_static_fire_sequence(const LoadStaticFireSequenceRequest& req);
std::expected<void, Error> handle_start_static_fire_sequence(const StartStaticFireSequenceRequest& req);

// Flight
std::expected<void, Error> handle_load_flight_sequence(const LoadFlightSequenceRequest& req);
std::expected<void, Error> handle_start_flight_sequence(const StartFlightSequenceRequest& req);
};  // namespace Controller
```
